## CMakeLists.txt
```
# Copyright (c) 2025 HARDWARIO a.s.
# SPDX-License-Identifier: Apache-2.0
#
# STICKER NFC bootloader (variant B). WIP — see boot/README.md.
# Build (interim, before sysbuild adoption):
#   west build -b sticker boot -d build/boot

cmake_minimum_required(VERSION 3.20.0)

find_package(Zephyr REQUIRED HINTS $ENV{ZEPHYR_BASE})
project(sticker_nfc_boot)

# Shared protocol contract (sticker/include is on the Zephyr include path
# via the module's top-level CMakeLists; add it explicitly for a standalone
# bootloader build too).
target_include_directories(app PRIVATE ${CMAKE_CURRENT_SOURCE_DIR}/../include)

target_sources(app PRIVATE
  src/main.c
  src/st25dv_mb.c
  src/flash_writer.c
  src/verify.c
  src/auth.c
)

# Phone-free crypto+erase self-test (diagnostic): build with -DBOOT_SELFTEST=ON.
if(BOOT_SELFTEST)
  zephyr_compile_definitions(CONFIG_BOOT_SELFTEST)
endif()

# DFU retry test hook (diagnostic): build with -DBOOT_DFU_FAULT_INJECT=ON to drop
# the response to one DATA frame once, forcing the phone to resend it so the
# idempotent re-ack path (#236) can be exercised on hardware.
if(BOOT_DFU_FAULT_INJECT)
  zephyr_compile_definitions(CONFIG_BOOT_DFU_FAULT_INJECT)
endif()
```

## prj.conf
```kconfig
# STICKER NFC bootloader — minimal Zephyr configuration.
# WIP: tune for the ~48 KB boot_partition once signature verify is wired.

# No bootloader chaining; this IS the first-stage image.
CONFIG_BOOTLOADER_MCUBOOT=n

# Link at boot_partition (0x0) and enforce its 48K bound (app.overlay chooses it).
CONFIG_USE_DT_CODE_PARTITION=y

# Peripherals.
CONFIG_I2C=y
CONFIG_GPIO=y
CONFIG_FLASH=y
CONFIG_FLASH_MAP=y
CONFIG_STREAM_FLASH=n

# CRC (crc32_ieee).
CONFIG_CRC=y

# sys_reboot().
CONFIG_REBOOT=y

# AES-CCM frame authentication (PSA/mbedTLS, same path as app config-ingest).
CONFIG_MBEDTLS=y
CONFIG_MBEDTLS_PSA_CRYPTO_C=y
CONFIG_PSA_WANT_KEY_TYPE_AES=y
CONFIG_PSA_WANT_ALG_CCM=y
CONFIG_ENTROPY_GENERATOR=y

# Size / footprint.
CONFIG_SIZE_OPTIMIZATIONS=y
CONFIG_MULTITHREADING=y
CONFIG_MAIN_STACK_SIZE=2048

# Minimal console for bring-up (drop in release). printk over SEGGER RTT so the
# DFU flow is observable on real hardware via J-Link (no UART routed).
CONFIG_PRINTK=y
CONFIG_CONSOLE=y
CONFIG_USE_SEGGER_RTT=y
CONFIG_RTT_CONSOLE=y
CONFIG_SEGGER_RTT_MODE_NO_BLOCK_SKIP=y

# No logging subsystem in the bootloader (keep it small).
CONFIG_LOG=n
```

## app.overlay
```dts
/*
 * The bootloader runs from boot_partition, not the application slot.
 * The board DTS defaults zephyr,code-partition to slot0 (for the app build);
 * override it here so the bootloader links at the boot partition base.
 */
/ {
	chosen {
		zephyr,code-partition = &boot_partition;
	};
};
```

## src/main.c
```c
/* STICKER NFC bootloader (#491) — bare-metal, no Zephyr, fits 4 KB.
 *
 * Boots the application at 0x08001000, or accepts a new application image over
 * the ST25DV FTM mailbox. No crypto, no image header, no metadata partition: the
 * application's vector table is the only validity marker, and its first flash
 * page is programmed last, after the image CRC passed. Any interrupted or failed
 * transfer therefore leaves an erased vector table and the next reset lands in
 * update mode again.
 *
 * Runs on MSI 4 MHz (reset clock) with PRIMASK set: interrupts only wake WFI
 * from Stop2, their handlers never run. See doc/plan/492 for the protocol. */

#include <stdbool.h>
#include <stdint.h>

#include "stm32wle5xx.h"

#define BOOT_VERSION 1

#define APP_ADDR  0x08001000UL
#define APP_END   0x08034000UL /* history partition */
#define SLOT_SIZE (APP_END - APP_ADDR)
#define PAGE_SIZE 2048UL

/* Last SRAM word, outside the bootloader's RAM window (boot.ld) and reserved in
 * the application: the app writes BOOT_MAGIC here and reboots (enter_dfu). */
#define BOOT_MAGIC_ADDR 0x2000FFFCUL
#define BOOT_MAGIC      0x21554644UL /* "DFU!" */

/* Update mode entered on request times out after this many idle LPTIM ticks. */
#define TICK_S         8
#define IDLE_TIMEOUT_S 240

/* ST25DV: user memory + dynamic registers on 0x53 (E0). */
#define ST25_ADDR        0x53
#define ST25_EH_CTRL     0x2002
#define ST25_FIELD_ON    0x04
#define ST25_MB_CTRL     0x2006
#define ST25_MB_EN       0x01
#define ST25_MB_HOST_PUT 0x02
#define ST25_MB_RF_PUT   0x04
#define ST25_MB_LEN      0x2007
#define ST25_MB_RAM      0x2008
#define ST25_RETRIES     20

/* Requests (first mailbox byte; distinct from the app's 0x01..0x03 channels). */
#define REQ_PING   0xB1
#define REQ_START  0xB2
#define REQ_DATA   0xB3
#define REQ_FINISH 0xB4

/* Reply: status(1) | expected offset(4, LE) | BOOT_VERSION(1). */
enum status {
	ST_OK = 0x00,
	ST_ERR_CMD = 0x01,
	ST_ERR_ARG = 0x02,
	ST_ERR_STATE = 0x03,
	ST_ERR_SEQ = 0x04,
	ST_ERR_FLASH = 0x05,
	ST_ERR_CRC = 0x06,
	ST_ERR_IMAGE = 0x07,
};

#define PIN_LPD   1  /* PA1: ST25DV low-power-down, low = tag powered */
#define PIN_LED_G 6  /* PA6: green LED, active low */
#define PIN_SCL   6  /* PB6: I2C1 SCL, AF4 */
#define PIN_SDA   7  /* PB7: I2C1 SDA, AF4 */
#define PIN_GPO   12 /* PB12: ST25DV GPO, EXTI12 */

#define FLASH_ERRS                                                                                 \
	(FLASH_SR_OPERR | FLASH_SR_PROGERR | FLASH_SR_WRPERR | FLASH_SR_PGAERR | FLASH_SR_SIZERR | \
	 FLASH_SR_PGSERR | FLASH_SR_MISERR | FLASH_SR_FASTERR)

static uint32_t m_page[PAGE_SIZE / 4]; /* first slot page, programmed at FINISH */
static uint8_t m_rx[256];
static uint8_t m_tx[6];
static uint32_t m_len;
static uint32_t m_crc;
static uint32_t m_exp;
static bool m_started;

static uint32_t rd32(const uint8_t *p)
{
	return p[0] | (p[1] << 8) | (p[2] << 16) | ((uint32_t)p[3] << 24);
}

static bool app_valid(const uint32_t *v)
{
	return v[0] > SRAM1_BASE && v[0] <= SRAM1_BASE + 0x10000 && (v[1] & 1) &&
	       v[1] >= APP_ADDR && v[1] < APP_END;
}

static void jump_to_app(void)
{
	SCB->VTOR = APP_ADDR;
	__asm volatile("msr msp, %0\n\tbx %1" ::"r"(((uint32_t *)APP_ADDR)[0]),
		       "r"(((uint32_t *)APP_ADDR)[1]));
}

static void iwdg_feed(void)
{
	/* The application starts the IWDG (10 s); it keeps running through the
	 * reboot into the bootloader and cannot be stopped. Harmless if not started. */
	IWDG->KR = 0xAAAA;
}

static void delay_ms(uint32_t ms)
{
	while (ms--) {
		iwdg_feed();
		while (!(SysTick->CTRL & SysTick_CTRL_COUNTFLAG_Msk)) {
		}
	}
}

static void gpio_mode(GPIO_TypeDef *port, uint32_t pin, uint32_t mode)
{
	port->MODER = (port->MODER & ~(3UL << (2 * pin))) | (mode << (2 * pin));
}

static void led(bool on)
{
	GPIOA->BSRR = on ? (1UL << (PIN_LED_G + 16)) : (1UL << PIN_LED_G);
}

/* ---- I2C1, polling ---------------------------------------------------------- */

static int i2c_wait(uint32_t flag)
{
	for (uint32_t n = 0; n < 100000; n++) {
		uint32_t isr = I2C1->ISR;

		if (isr & flag) {
			return 0;
		}
		if (isr & I2C_ISR_NACKF) {
			break; /* the master sends STOP by itself after a NACK */
		}
	}
	/* Software reset clears the state machine and every flag. */
	I2C1->CR1 = 0;
	I2C1->CR1 = I2C_CR1_PE;
	return -1;
}

/* One transaction on the 16-bit register space: write reg(+data) or reg then read. */
static int st25_xfer_once(uint16_t reg, uint8_t *buf, uint32_t len, bool read)
{
	uint32_t sadd = ST25_ADDR << 1;
	uint32_t n = read ? 2 : 2 + len;

	I2C1->CR2 = sadd | (n << I2C_CR2_NBYTES_Pos) | (read ? 0 : I2C_CR2_AUTOEND) | I2C_CR2_START;
	for (uint32_t i = 0; i < n; i++) {
		if (i2c_wait(I2C_ISR_TXIS)) {
			return -1;
		}
		I2C1->TXDR = i == 0 ? reg >> 8 : i == 1 ? reg & 0xFF : buf[i - 2];
	}
	if (read) {
		if (i2c_wait(I2C_ISR_TC)) {
			return -1;
		}
		I2C1->CR2 = sadd | I2C_CR2_RD_WRN | (len << I2C_CR2_NBYTES_Pos) | I2C_CR2_AUTOEND |
			    I2C_CR2_START;
		for (uint32_t i = 0; i < len; i++) {
			if (i2c_wait(I2C_ISR_RXNE)) {
				return -1;
			}
			buf[i] = I2C1->RXDR;
		}
	}
	if (i2c_wait(I2C_ISR_STOPF)) {
		return -1;
	}
	I2C1->ICR = I2C_ICR_STOPCF;
	return 0;
}

/* RF owns the dual port while it talks to the tag: the tag NACKs, so retry. */
static int st25_xfer(uint16_t reg, uint8_t *buf, uint32_t len, bool read)
{
	for (int i = 0; i < ST25_RETRIES; i++) {
		if (!st25_xfer_once(reg, buf, len, read)) {
			return 0;
		}
		delay_ms(2);
	}
	return -1;
}

static int st25_read(uint16_t reg, uint8_t *buf, uint32_t len)
{
	/* NBYTES is 8 bits: split a full 256 B mailbox. */
	while (len) {
		uint32_t chunk = len > 128 ? 128 : len;

		if (st25_xfer(reg, buf, chunk, true)) {
			return -1;
		}
		reg += chunk;
		buf += chunk;
		len -= chunk;
	}
	return 0;
}

static int st25_write1(uint16_t reg, uint8_t v)
{
	return st25_xfer(reg, &v, 1, false);
}

/* ---- Flash ------------------------------------------------------------------- */

static int flash_wait(void)
{
	while (FLASH->SR & (FLASH_SR_BSY | FLASH_SR_CFGBSY)) {
	}
	uint32_t err = FLASH->SR & FLASH_ERRS;

	FLASH->SR = FLASH_ERRS;
	FLASH->CR = 0;
	return err ? -1 : 0;
}

static int flash_erase_page(uint32_t page)
{
	flash_wait();
	FLASH->CR = FLASH_CR_PER | (page << FLASH_CR_PNB_Pos);
	FLASH->CR |= FLASH_CR_STRT;
	return flash_wait();
}

static int flash_program(uint32_t addr, uint32_t lo, uint32_t hi)
{
	flash_wait();
	FLASH->CR = FLASH_CR_PG;
	*(volatile uint32_t *)addr = lo;
	__ISB();
	*(volatile uint32_t *)(addr + 4) = hi;
	return flash_wait();
}

/* ---- Protocol ---------------------------------------------------------------- */

static uint32_t image_crc(void)
{
	/* CRC-32 (IEEE 802.3, as zlib) on the CRC unit: word-reversed input and
	 * reversed output, init 0xFFFFFFFF, final XOR in software. */
	CRC->CR = CRC_CR_REV_IN | CRC_CR_REV_OUT | CRC_CR_RESET;

	uint32_t first = m_len < PAGE_SIZE ? m_len : PAGE_SIZE;

	for (uint32_t i = 0; i < first; i += 4) {
		CRC->DR = m_page[i / 4];
	}
	for (uint32_t a = APP_ADDR + PAGE_SIZE; a < APP_ADDR + m_len; a += 4) {
		CRC->DR = *(const uint32_t *)a;
	}
	return ~CRC->DR;
}

static enum status req_start(uint32_t n)
{
	if (n != 9) {
		return ST_ERR_ARG;
	}
	uint32_t len = rd32(&m_rx[1]);

	if (len == 0 || len > SLOT_SIZE || (len & 7)) {
		return ST_ERR_ARG;
	}

	m_started = false;
	uint32_t first = (APP_ADDR - FLASH_BASE) / PAGE_SIZE;
	uint32_t last = (APP_ADDR - FLASH_BASE + len - 1) / PAGE_SIZE;

	for (uint32_t p = first; p <= last; p++) {
		iwdg_feed();
		if (flash_erase_page(p)) {
			return ST_ERR_FLASH;
		}
	}
	/* Drop flash data-cache lines of the erased pages. */
	FLASH->ACR &= ~FLASH_ACR_DCEN;
	FLASH->ACR |= FLASH_ACR_DCRST;
	FLASH->ACR &= ~FLASH_ACR_DCRST;
	FLASH->ACR |= FLASH_ACR_DCEN;

	for (uint32_t i = 0; i < PAGE_SIZE / 4; i++) {
		m_page[i] = 0xFFFFFFFF;
	}
	m_len = len;
	m_crc = rd32(&m_rx[5]);
	m_exp = 0;
	m_started = true;
	return ST_OK;
}

static enum status req_data(uint32_t n)
{
	if (!m_started) {
		return ST_ERR_STATE;
	}
	if (n < 5 + 8 || ((n - 5) & 7)) {
		return ST_ERR_ARG;
	}
	uint32_t off = rd32(&m_rx[1]);
	uint32_t cnt = n - 5;

	if (off != m_exp) {
		/* Already written: a retried frame. Ahead: resume from m_exp. */
		return off < m_exp ? ST_OK : ST_ERR_SEQ;
	}
	if (off + cnt > m_len) {
		return ST_ERR_ARG;
	}
	for (uint32_t i = 0; i < cnt; i += 8) {
		uint32_t a = off + i;
		uint32_t lo = rd32(&m_rx[5 + i]);
		uint32_t hi = rd32(&m_rx[9 + i]);

		if (a < PAGE_SIZE) {
			m_page[a / 4] = lo;
			m_page[a / 4 + 1] = hi;
		} else if (flash_program(APP_ADDR + a, lo, hi)) {
			m_started = false;
			return ST_ERR_FLASH;
		}
	}
	m_exp += cnt;
	return ST_OK;
}

static enum status req_finish(void)
{
	if (!m_started || m_exp != m_len) {
		return ST_ERR_STATE;
	}
	if (image_crc() != m_crc) {
		return ST_ERR_CRC;
	}
	if (!app_valid(m_page)) {
		return ST_ERR_IMAGE;
	}
	/* From the end down: the first double-word (SP + reset vector) goes last, so
	 * a power loss in between leaves an erased, invalid vector table. */
	uint32_t first = m_len < PAGE_SIZE ? m_len : PAGE_SIZE;

	for (uint32_t a = first; a;) {
		a -= 8;
		if (flash_program(APP_ADDR + a, m_page[a / 4], m_page[a / 4 + 1])) {
			m_started = false;
			return ST_ERR_FLASH;
		}
	}
	m_started = false;
	return ST_OK;
}

/* Leave the tag as the application expects it (mailbox off, tag unpowered). */
static void leave(void)
{
	st25_write1(ST25_MB_CTRL, 0);
	GPIOA->BSRR = 1UL << PIN_LPD;
	NVIC_SystemReset();
}

/* Read one request, write its reply. Returns true when the new image is in. */
static bool serve(void)
{
	uint8_t lenm1;

	if (st25_read(ST25_MB_LEN, &lenm1, 1)) {
		return false;
	}
	uint32_t n = lenm1 + 1UL;

	if (st25_read(ST25_MB_RAM, m_rx, n)) {
		return false;
	}

	enum status st;

	switch (m_rx[0]) {
	case REQ_PING:
		st = ST_OK;
		break;
	case REQ_START:
		st = req_start(n);
		break;
	case REQ_DATA:
		st = req_data(n);
		break;
	case REQ_FINISH:
		st = req_finish();
		break;
	default:
		st = ST_ERR_CMD;
		break;
	}

	m_tx[0] = st;
	m_tx[1] = m_exp;
	m_tx[2] = m_exp >> 8;
	m_tx[3] = m_exp >> 16;
	m_tx[4] = m_exp >> 24;
	m_tx[5] = BOOT_VERSION;
	st25_xfer(ST25_MB_RAM, m_tx, sizeof(m_tx), false);

	return m_rx[0] == REQ_FINISH && st == ST_OK;
}

static void hw_init(void)
{
	/* 1 ms SysTick period on the 4 MHz reset clock, polled (no interrupt). */
	SysTick->LOAD = 4000 - 1;
	SysTick->VAL = 0;
	SysTick->CTRL = SysTick_CTRL_CLKSOURCE_Msk | SysTick_CTRL_ENABLE_Msk;

	RCC->AHB1ENR |= RCC_AHB1ENR_CRCEN;
	RCC->AHB2ENR |= RCC_AHB2ENR_GPIOAEN | RCC_AHB2ENR_GPIOBEN;
	RCC->APB1ENR1 |= RCC_APB1ENR1_I2C1EN | RCC_APB1ENR1_LPTIM1EN;
	(void)RCC->APB1ENR1;

	/* Tag powered, LED off. */
	GPIOA->BSRR = (1UL << (PIN_LPD + 16)) | (1UL << PIN_LED_G);
	gpio_mode(GPIOA, PIN_LPD, 1);
	gpio_mode(GPIOA, PIN_LED_G, 1);

	/* I2C1 on PB6/PB7, AF4 open-drain (external pull-ups), 100 kHz @ 4 MHz. */
	GPIOB->OTYPER |= (1UL << PIN_SCL) | (1UL << PIN_SDA);
	GPIOB->AFR[0] = (GPIOB->AFR[0] & ~0xFF000000UL) | 0x44000000UL;
	gpio_mode(GPIOB, PIN_SCL, 2);
	gpio_mode(GPIOB, PIN_SDA, 2);
	I2C1->TIMINGR = 0x00420F13;
	I2C1->CR1 = I2C_CR1_PE;

	/* GPO on PB12 (input, pull-down) wakes Stop2 via EXTI12 (rising). */
	gpio_mode(GPIOB, PIN_GPO, 0);
	GPIOB->PUPDR = (GPIOB->PUPDR & ~(3UL << (2 * PIN_GPO))) | (2UL << (2 * PIN_GPO));
	SYSCFG->EXTICR[3] = (SYSCFG->EXTICR[3] & ~7UL) | 1; /* EXTI12 = port B */
	EXTI->RTSR1 |= 1UL << PIN_GPO;
	EXTI->IMR1 |= (1UL << PIN_GPO) | EXTI_IMR1_IM29; /* + LPTIM1 wake line */
	NVIC_EnableIRQ(EXTI15_10_IRQn);

	/* LPTIM1 on LSI/128 = 250 Hz, wakes Stop2 every TICK_S to feed the IWDG. */
	RCC->CSR |= RCC_CSR_LSION;
	while (!(RCC->CSR & RCC_CSR_LSIRDY)) {
	}
	RCC->CCIPR = (RCC->CCIPR & ~RCC_CCIPR_LPTIM1SEL) | RCC_CCIPR_LPTIM1SEL_0;
	LPTIM1->CFGR = 7UL << LPTIM_CFGR_PRESC_Pos;
	LPTIM1->IER = LPTIM_IER_ARRMIE;
	LPTIM1->CR = LPTIM_CR_ENABLE;
	LPTIM1->ARR = 250 * TICK_S - 1;
	LPTIM1->CR |= LPTIM_CR_CNTSTRT;
	NVIC_EnableIRQ(LPTIM1_IRQn);
}

static void stop2(void)
{
	led(false);
	NVIC_ClearPendingIRQ(EXTI15_10_IRQn);
	NVIC_ClearPendingIRQ(LPTIM1_IRQn);
	if (EXTI->PR1 & (1UL << PIN_GPO)) {
		return; /* GPO pulsed since the last check */
	}
	PWR->CR1 = (PWR->CR1 & ~PWR_CR1_LPMS) | PWR_CR1_LPMS_1;
	SCB->SCR |= SCB_SCR_SLEEPDEEP_Msk;
	__DSB();
	__WFI(); /* PRIMASK is set: wakes on the pending IRQ, never runs a handler */
	SCB->SCR &= ~SCB_SCR_SLEEPDEEP_Msk;
}

static void update_mode(bool timeout)
{
	uint32_t idle = 0;

	__disable_irq();
	hw_init();
	delay_ms(150); /* tag boot after LPD low */

	for (;;) {
		iwdg_feed();
		EXTI->PR1 = 1UL << PIN_GPO;

		if (LPTIM1->ISR & LPTIM_ISR_ARRM) {
			LPTIM1->ICR = LPTIM_ICR_ARRMCF;
			if (timeout && ++idle >= IDLE_TIMEOUT_S / TICK_S) {
				leave(); /* nothing written yet: the old application boots */
			}
		}

		uint8_t ctrl = 0;
		uint8_t eh = 0;

		if (st25_read(ST25_MB_CTRL, &ctrl, 1) || st25_read(ST25_EH_CTRL, &eh, 1)) {
			stop2();
			continue;
		}
		if (!(ctrl & ST25_MB_EN)) {
			st25_write1(ST25_MB_CTRL, ST25_MB_EN);
		}
		if (ctrl & ST25_MB_RF_PUT) {
			led(true);
			idle = 0;
			if (serve()) {
				/* Let the phone read the final ACK, then boot the new image. */
				for (int i = 0; i < 100; i++) {
					delay_ms(10);
					if (!st25_read(ST25_MB_CTRL, &ctrl, 1) &&
					    !(ctrl & ST25_MB_HOST_PUT)) {
						break;
					}
				}
				leave();
			}
			continue;
		}
		if (eh & ST25_FIELD_ON) {
			/* Phone present: poll, do not depend on the GPO configuration. */
			led(true);
			delay_ms(2);
			continue;
		}
		stop2();
	}
}

int main(void)
{
	volatile uint32_t *magic = (volatile uint32_t *)BOOT_MAGIC_ADDR;
	bool requested = *magic == BOOT_MAGIC;
	bool valid = app_valid((const uint32_t *)APP_ADDR);

	*magic = 0;

	if (valid && !requested) {
		jump_to_app();
	}

	update_mode(valid);

	return 0;
}
```

## src/auth.c
```c
/*
 * Copyright (c) 2025 HARDWARIO a.s.
 *
 * SPDX-License-Identifier: Apache-2.0
 */

#include "auth.h"

#include <zephyr/sys/byteorder.h>

#include <psa/crypto.h>

#include <string.h>

#define CCM_ALG PSA_ALG_AEAD_WITH_SHORTENED_TAG(PSA_ALG_CCM, NFC_CCM_TAG_LEN)

static uint8_t m_key[NFC_KEY_LEN];
static uint32_t m_serial;
static uint32_t m_session;
static bool m_keyed;
static psa_key_id_t m_key_id;
static bool m_key_ready;

static bool all_zero(const uint8_t *p, size_t n)
{
	for (size_t i = 0; i < n; i++) {
		if (p[i] != 0) {
			return false;
		}
	}
	return true;
}

void auth_set_key(const uint8_t key[NFC_KEY_LEN], uint32_t serial)
{
	memcpy(m_key, key, NFC_KEY_LEN);
	m_serial = serial;
	m_keyed = !all_zero(m_key, NFC_KEY_LEN);
	m_key_ready = false; /* imported lazily on first decrypt */
}

bool auth_is_keyed(void)
{
	return m_keyed;
}

void auth_set_session(uint32_t session)
{
	m_session = session;
}

const uint8_t *auth_key(void)
{
	return m_key;
}

uint32_t auth_serial(void)
{
	return m_serial;
}

static void build_nonce(uint8_t nonce[NFC_CCM_NONCE_LEN], uint32_t seq)
{
	sys_put_le32(m_serial, &nonce[0]);
	sys_put_le32(m_session, &nonce[4]);
	sys_put_le32(seq, &nonce[8]);
	nonce[12] = 0;
}

static int ensure_key(void)
{
	if (m_key_ready) {
		return 0;
	}
	if (psa_crypto_init() != PSA_SUCCESS) {
		return -1;
	}

	psa_key_attributes_t attr = PSA_KEY_ATTRIBUTES_INIT;

	psa_set_key_usage_flags(&attr, PSA_KEY_USAGE_DECRYPT);
	psa_set_key_algorithm(&attr, CCM_ALG);
	psa_set_key_type(&attr, PSA_KEY_TYPE_AES);
	psa_set_key_bits(&attr, PSA_BYTES_TO_BITS(NFC_KEY_LEN));

	if (psa_import_key(&attr, m_key, NFC_KEY_LEN, &m_key_id) != PSA_SUCCESS) {
		return -1;
	}
	m_key_ready = true;
	return 0;
}

int auth_decrypt(uint32_t seq, const uint8_t *in, size_t in_len, uint8_t *out,
		 size_t *out_len)
{
	if (!m_keyed) {
		memcpy(out, in, in_len);
		*out_len = in_len;
		return 0;
	}

	if (in_len < NFC_CCM_TAG_LEN || ensure_key() != 0) {
		return -1;
	}

	uint8_t nonce[NFC_CCM_NONCE_LEN];

	build_nonce(nonce, seq);

	size_t olen = 0;
	psa_status_t st = psa_aead_decrypt(m_key_id, CCM_ALG, nonce, NFC_CCM_NONCE_LEN,
					   NULL, 0, in, in_len, out, in_len, &olen);

	if (st != PSA_SUCCESS) {
		return -1;
	}
	*out_len = olen;
	return 0;
}
```

## src/auth.h
```c
/*
 * Copyright (c) 2025 HARDWARIO a.s.
 *
 * SPDX-License-Identifier: Apache-2.0
 *
 * Symmetric AES-CCM authentication for NFC firmware update frames.
 * All-zero key => unkeyed (factory): frames pass through as plaintext.
 */

#ifndef STICKER_BOOT_AUTH_H
#define STICKER_BOOT_AUTH_H

#include <sticker/nfc_proto.h>

#include <stdbool.h>
#include <stddef.h>
#include <stdint.h>

/* Load the device key (from sfu_meta). Sets unkeyed mode if key is all-zero. */
void auth_set_key(const uint8_t key[NFC_KEY_LEN], uint32_t serial);

/* True if a non-zero key is loaded (frames must be CCM-authenticated). */
bool auth_is_keyed(void);

/* Per-session nonce diversifier from CMD_START. */
void auth_set_session(uint32_t session);

/* Currently loaded key/serial (for the bootloader to persist into sfu_meta). */
const uint8_t *auth_key(void);
uint32_t auth_serial(void);

/*
 * Decrypt+verify one frame at sequence `seq`. When keyed, `in` is
 * ciphertext||tag (in_len includes the tag) and `out` receives in_len-tag
 * plaintext bytes. When unkeyed, the frame is copied verbatim. Returns 0 on
 * success (tag verified), negative on auth failure or bad size.
 * `out` must have capacity for at least in_len bytes.
 */
int auth_decrypt(uint32_t seq, const uint8_t *in, size_t in_len, uint8_t *out,
		 size_t *out_len);

#endif /* STICKER_BOOT_AUTH_H */
```

## src/flash_writer.c
```c
/*
 * Copyright (c) 2025 HARDWARIO a.s.
 *
 * SPDX-License-Identifier: Apache-2.0
 */

#include "flash_writer.h"

#include <zephyr/devicetree.h>
#include <zephyr/storage/flash_map.h>
#include <zephyr/sys/crc.h>
#include <zephyr/sys/printk.h>
#include <zephyr/sys/util.h>

#include <errno.h>
#include <string.h>

#define SLOT0_ID FIXED_PARTITION_ID(slot0_partition)
#define SLOT0_OFFSET FIXED_PARTITION_OFFSET(slot0_partition)
#define SLOT0_SIZE FIXED_PARTITION_SIZE(slot0_partition)

#define FLASH_BASE DT_REG_ADDR(DT_CHOSEN(zephyr_flash))

/*
 * sfu_meta lives in its own fixed partition. The DTS partition redesign
 * (doc §7, Phase 2 remaining work) must add `sfu_meta_partition`; until then
 * this references it so the dependency is explicit.
 */
#define META_ID FIXED_PARTITION_ID(sfu_meta_partition)
#define META_SIZE FIXED_PARTITION_SIZE(sfu_meta_partition)

#define CRC_CHUNK 256

/* STM32WLE5 main flash: uniform 2 KB pages (the erase granularity). */
#define FW_PAGE_SZ  2048
#define FW_MAX_PAGES ((SLOT0_SIZE + FW_PAGE_SZ - 1) / FW_PAGE_SZ)

/* Incremental-erase bookkeeping: one bit per slot page, set once the page has
 * been erased during this session. */
static uint8_t m_erased[(FW_MAX_PAGES + 7) / 8];
static bool m_incremental;

void fw_begin_incremental(void)
{
	memset(m_erased, 0, sizeof(m_erased));
	m_incremental = true;
}

/* Erase any not-yet-erased page(s) covering [off, off+len). */
static int ensure_erased(const struct flash_area *fa, uint32_t off, size_t len)
{
	uint32_t first = off / FW_PAGE_SZ;
	uint32_t last = (off + len - 1) / FW_PAGE_SZ;

	for (uint32_t p = first; p <= last && p < FW_MAX_PAGES; p++) {
		if (m_erased[p / 8] & (1u << (p % 8))) {
			continue;
		}
		int ret = flash_area_erase(fa, (off_t)p * FW_PAGE_SZ, FW_PAGE_SZ);

		if (ret) {
			printk("DFU: ERASE page %u @0x%lx FAILED: %d\n", p,
			       (unsigned long)((off_t)p * FW_PAGE_SZ), ret);
			return ret;
		}
		m_erased[p / 8] |= (1u << (p % 8));
	}
	return 0;
}

uint32_t fw_slot0_base(void)
{
	return (uint32_t)(FLASH_BASE + SLOT0_OFFSET);
}

size_t fw_slot0_size(void)
{
	return SLOT0_SIZE;
}

int fw_erase_slot(void)
{
	const struct flash_area *fa;
	int ret = flash_area_open(SLOT0_ID, &fa);

	if (ret) {
		return ret;
	}
	ret = flash_area_erase(fa, 0, SLOT0_SIZE);
	flash_area_close(fa);
	return ret;
}

int fw_write(uint32_t off, const uint8_t *data, size_t len)
{
	const struct flash_area *fa;
	int ret = flash_area_open(SLOT0_ID, &fa);

	if (ret) {
		return ret;
	}
	if (off + len > SLOT0_SIZE) {
		flash_area_close(fa);
		return -EFBIG;
	}
	if (m_incremental) {
		ret = ensure_erased(fa, off, len);
		if (ret) {
			flash_area_close(fa);
			return ret;
		}
	}
	ret = flash_area_write(fa, off, data, len);
	if (ret) {
		printk("DFU: WRITE @0x%lx len=%u FAILED: %d\n", (unsigned long)off,
		       (unsigned)len, ret);
	}
	flash_area_close(fa);
	return ret;
}

int fw_read(uint32_t off, uint8_t *data, size_t len)
{
	const struct flash_area *fa;
	int ret = flash_area_open(SLOT0_ID, &fa);

	if (ret) {
		return ret;
	}
	ret = flash_area_read(fa, off, data, len);
	flash_area_close(fa);
	return ret;
}

int fw_slot_crc32(size_t len, uint32_t *crc)
{
	const struct flash_area *fa;
	int ret = flash_area_open(SLOT0_ID, &fa);

	if (ret) {
		return ret;
	}

	uint8_t buf[CRC_CHUNK];
	uint32_t acc = 0;
	size_t off = 0;

	while (off < len) {
		size_t n = MIN((size_t)CRC_CHUNK, len - off);

		ret = flash_area_read(fa, off, buf, n);
		if (ret) {
			break;
		}
		acc = crc32_ieee_update(acc, buf, n);
		off += n;
	}

	flash_area_close(fa);
	if (ret == 0) {
		*crc = acc;
	}
	return ret;
}

int meta_read(struct sfu_meta *meta)
{
	const struct flash_area *fa;
	int ret = flash_area_open(META_ID, &fa);

	if (ret) {
		return ret;
	}
	ret = flash_area_read(fa, 0, meta, sizeof(*meta));
	flash_area_close(fa);
	return ret;
}

int meta_write(const struct sfu_meta *meta)
{
	const struct flash_area *fa;
	int ret = flash_area_open(META_ID, &fa);

	if (ret) {
		return ret;
	}
	ret = flash_area_erase(fa, 0, META_SIZE);
	if (ret == 0) {
		/* STM32WL flash writes in 8-byte (doubleword) units, so the length
		 * must be a multiple of 8; sizeof(sfu_meta) is 36. Pad to the next
		 * doubleword in a zero-filled buffer (erased flash reads 0xFF, so the
		 * pad bytes are explicit). */
		uint8_t buf[ROUND_UP(sizeof(*meta), 8)] = {0};

		memcpy(buf, meta, sizeof(*meta));
		ret = flash_area_write(fa, 0, buf, sizeof(buf));
	}
	flash_area_close(fa);
	return ret;
}
```

## src/flash_writer.h
```c
/*
 * Copyright (c) 2025 HARDWARIO a.s.
 *
 * SPDX-License-Identifier: Apache-2.0
 *
 * slot0 erase/write and sfu_meta persistence for the NFC bootloader.
 * WIP scaffold — not yet HW-tested.
 */

#ifndef STICKER_BOOT_FLASH_WRITER_H
#define STICKER_BOOT_FLASH_WRITER_H

#include <sticker/nfc_proto.h>

#include <stddef.h>
#include <stdint.h>

/* Absolute address the application is linked at (slot0 base). */
uint32_t fw_slot0_base(void);

/* Usable application slot size in bytes. */
size_t fw_slot0_size(void);

/* Erase the whole application slot in preparation for a new image. */
int fw_erase_slot(void);

/* Arm incremental (lazy) erase: subsequent fw_write() calls erase each flash
 * page on first touch. Use instead of fw_erase_slot() so CMD_START can reply
 * immediately — a full 162 KB bulk erase (~1.7 s) outlasts the phone's mailbox
 * poll window and livelocks the handshake. Resets the per-page erased state. */
void fw_begin_incremental(void);

/* Write `len` bytes at `off` within the application slot (erasing the covering
 * page(s) first when in incremental mode). */
int fw_write(uint32_t off, const uint8_t *data, size_t len);

/* Read `len` bytes at `off` from the application slot. */
int fw_read(uint32_t off, uint8_t *data, size_t len);

/* CRC-32/IEEE over the first `len` bytes already written to the slot. */
int fw_slot_crc32(size_t len, uint32_t *crc);

/* Read / write the validity metadata record. */
int meta_read(struct sfu_meta *meta);
int meta_write(const struct sfu_meta *meta);

#endif /* STICKER_BOOT_FLASH_WRITER_H */
```

## src/fw_signing_key.h
```c
/*
 * Copyright (c) 2026 HARDWARIO a.s.
 *
 * SPDX-License-Identifier: Apache-2.0
 *
 * Ed25519 public key that the NFC bootloader trusts for firmware image
 * signatures (see doc/nfc-update-protocol.md). Only an image signed by the
 * matching private key is accepted when CONFIG_BOOT_REQUIRE_SIGNATURE is set.
 *
 * !! DEVELOPMENT KEY !! Replace with the production key (and keep its private
 * half in an HSM / CI secret) before shipping. The matching private key was
 * generated alongside this and must NOT live in the repo.
 */

#ifndef STICKER_BOOT_FW_SIGNING_KEY_H
#define STICKER_BOOT_FW_SIGNING_KEY_H

#include <stdint.h>

/* Ed25519 raw public key (32 bytes). */
static const uint8_t FW_SIGNING_PUBLIC_KEY[32] = {
	0x32, 0xea, 0xc1, 0x0c, 0xed, 0x81, 0x47, 0x42, 0x32, 0x00, 
	0x30, 0xfc, 0xeb, 0xef, 0x83, 0x88, 0x82, 0x5c, 0x50, 0x58, 
	0x0f, 0x64, 0x8c, 0xaa, 0x5f, 0xed, 0x96, 0xf2, 0xee, 0x3b, 
	0x39, 0x2e, 
};

#endif /* STICKER_BOOT_FW_SIGNING_KEY_H */
```

## src/st25dv_mb.c
```c
/*
 * Copyright (c) 2025 HARDWARIO a.s.
 *
 * SPDX-License-Identifier: Apache-2.0
 *
 * ST25DV FTM (Fast-Transfer-Mode) mailbox transport for the NFC bootloader.
 * Mirrors the HW-proven application path in app/src/app_nfc.c: a single 256-byte
 * volatile RAM buffer is shared half-duplex between the RF (phone) and I2C (MCU)
 * sides. No EEPROM wear, no 5 ms page-programming wait — a whole frame moves in
 * one I2C transaction. See doc/nfc-update-protocol.md §4.
 */

#include "st25dv_mb.h"

#include <sticker/nfc_proto.h>

#include <zephyr/device.h>
#include <zephyr/devicetree.h>
#include <zephyr/drivers/gpio.h>
#include <zephyr/drivers/i2c.h>
#include <zephyr/kernel.h>
#include <zephyr/sys/byteorder.h>

#include <errno.h>
#include <string.h>

/* ST25DV I2C device addresses: E0 (0x53) = user memory + dynamic registers
 * (>=0x2000); E1 (0x57) = static system config (<0x2000) + password session. */
#define ST25DV_I2C_ADDR_E0 0x53
#define ST25DV_I2C_ADDR_E1 0x57

#define ST25DV_I2C_PWD_REG 0x0900 /* present-password register (E1) */

/* Fast-Transfer-Mode mailbox registers (see app_nfc.c for the full notes):
 * MB_MODE (static, E1 0x000D) bit0 must be 1 to allow the mailbox at all;
 * MB_CTRL_Dyn (dynamic, E0 0x2006) MB_EN turns it on, RF_PUT/HOST_PUT report
 * who wrote last; MB_LEN_Dyn (E0 0x2007) holds (message length - 1); the message
 * bytes live in MAILBOX_RAM (E0 0x2008..0x2107). */
#define ST25DV_MB_MODE_REG      0x000D
#define ST25DV_MB_MODE_EN       0x01
#define ST25DV_MB_CTRL_DYN      0x2006
#define ST25DV_MB_CTRL_MB_EN    0x01 /* bit0: mailbox enable */
#define ST25DV_MB_CTRL_HOST_PUT 0x02 /* bit1: host (I2C) wrote a message */
#define ST25DV_MB_CTRL_RF_PUT   0x04 /* bit2: RF (phone) wrote a message */
#define ST25DV_MB_LEN_DYN       0x2007
#define ST25DV_MB_RAM           0x2008

#define ST25DV_TW_MS_PER_PAGE 5 /* EEPROM page programming time */

static const struct device *const m_i2c = DEVICE_DT_GET(DT_NODELABEL(i2c1));
static const struct gpio_dt_spec m_lpd = GPIO_DT_SPEC_GET(DT_NODELABEL(lpd), gpios);

/* Dynamic registers (>=0x2000) live on E0; the static system config on E1. */
static inline uint8_t reg_dev_addr(uint16_t reg)
{
	return (reg >= 0x2000) ? ST25DV_I2C_ADDR_E0 : ST25DV_I2C_ADDR_E1;
}

static int read_reg(uint16_t reg, void *buf, size_t len)
{
	uint8_t addr[2];

	sys_put_be16(reg, addr);
	return i2c_write_read(m_i2c, reg_dev_addr(reg), addr, sizeof(addr), buf, len);
}

static int write_reg(uint16_t reg, const void *buf, size_t len)
{
	uint8_t frame[2 + 16];

	if (len > 16) {
		return -EINVAL;
	}
	sys_put_be16(reg, frame);
	memcpy(&frame[2], buf, len);
	return i2c_write(m_i2c, frame, 2 + len, reg_dev_addr(reg));
}

/* Read mailbox RAM (E0, up to 256 bytes in one transaction). */
static int read_mem(uint16_t reg, void *buf, size_t len)
{
	uint8_t addr[2];

	sys_put_be16(reg, addr);
	return i2c_write_read(m_i2c, ST25DV_I2C_ADDR_E0, addr, sizeof(addr), buf, len);
}

/* Open the I2C security session by presenting an 8-byte password (required to
 * write the static MB_MODE bit). Frame: addr(2) + pwd(8) + 0x09 + pwd(8). */
static int present_password(const uint8_t pwd[8])
{
	uint8_t frame[2 + 8 + 1 + 8];

	sys_put_be16(ST25DV_I2C_PWD_REG, frame);
	memcpy(&frame[2], pwd, 8);
	frame[10] = 0x09;
	memcpy(&frame[11], pwd, 8);
	return i2c_write(m_i2c, frame, sizeof(frame), ST25DV_I2C_ADDR_E1);
}

/* Write the whole mailbox in one I2C transaction (volatile RAM, no program
 * wait). Writing MAILBOX_RAM arms HOST_PUT_MSG so the RF side can read it. */
static int mb_write(const uint8_t *data, size_t len)
{
	uint8_t frame[2 + NFC_MB_RAM_SIZE];

	if (len == 0 || len > NFC_MB_RAM_SIZE) {
		return -EINVAL;
	}
	sys_put_be16(ST25DV_MB_RAM, frame);
	memcpy(&frame[2], data, len);
	return i2c_write(m_i2c, frame, 2 + len, ST25DV_I2C_ADDR_E0);
}

/* Enable the mailbox: set the static MB_MODE allow-bit (needs the I2C password)
 * then the dynamic MB_EN. The default factory password is all-zero. */
static int mb_enable(void)
{
	static const uint8_t default_pwd[8] = {0};
	uint8_t mode = 0;
	uint8_t ctrl;
	int ret;

	ret = present_password(default_pwd);
	if (ret) {
		return ret;
	}
	k_msleep(15);

	ret = read_reg(ST25DV_MB_MODE_REG, &mode, 1);
	if (ret) {
		return ret;
	}
	if (!(mode & ST25DV_MB_MODE_EN)) {
		mode |= ST25DV_MB_MODE_EN;
		ret = write_reg(ST25DV_MB_MODE_REG, &mode, 1);
		if (ret) {
			return ret;
		}
		k_msleep(ST25DV_TW_MS_PER_PAGE + 5);
	}

	ctrl = ST25DV_MB_CTRL_MB_EN;
	ret = write_reg(ST25DV_MB_CTRL_DYN, &ctrl, 1);
	if (ret) {
		return ret;
	}
	k_msleep(1);
	return 0;
}

int mb_init(void)
{
	int ret;

	if (!device_is_ready(m_i2c)) {
		return -ENODEV;
	}
	if (!gpio_is_ready_dt(&m_lpd)) {
		return -ENODEV;
	}

	/* Power the ST25DV (lpd active drives it on; see app_nfc.c) and keep it on. */
	ret = gpio_pin_configure_dt(&m_lpd, GPIO_OUTPUT_ACTIVE);
	if (ret) {
		return ret;
	}
	ret = gpio_pin_set_dt(&m_lpd, 0);
	if (ret) {
		return ret;
	}
	k_msleep(150);

	return mb_enable();
}

int mb_wait_request(uint8_t *frame, size_t cap, size_t *len, int timeout_ms)
{
	int64_t deadline = k_uptime_get() + timeout_ms;
	uint8_t ctrl = 0;
	uint8_t lenm1;
	int ret;

	/* Poll MB_CTRL_Dyn for RF_PUT (the phone wrote a request). */
	do {
		ret = read_reg(ST25DV_MB_CTRL_DYN, &ctrl, 1);
		if (ret) {
			return ret;
		}
		if (ctrl & ST25DV_MB_CTRL_RF_PUT) {
			break;
		}
		k_msleep(10);
	} while (k_uptime_get() < deadline);

	if (!(ctrl & ST25DV_MB_CTRL_RF_PUT)) {
		return -ETIMEDOUT;
	}

	/* MB_LEN_Dyn holds (length - 1) of the message just written by RF. */
	ret = read_reg(ST25DV_MB_LEN_DYN, &lenm1, 1);
	if (ret) {
		return ret;
	}

	size_t total = (size_t)lenm1 + 1;

	if (total > cap || total > NFC_MB_RAM_SIZE) {
		return -EMSGSIZE;
	}

	ret = read_mem(ST25DV_MB_RAM, frame, total);
	if (ret) {
		return ret;
	}

	*len = total;
	return 0;
}

int mb_send_response(const uint8_t *rsp, size_t len)
{
	if (len == 0 || len > NFC_MB_RAM_SIZE) {
		return -EMSGSIZE;
	}
	/* Writing the mailbox arms HOST_PUT_MSG; the phone polls and reads it. */
	return mb_write(rsp, len);
}
```

## src/st25dv_mb.h
```c
/*
 * Copyright (c) 2025 HARDWARIO a.s.
 *
 * SPDX-License-Identifier: Apache-2.0
 *
 * ST25DV EEPROM software-mailbox transport for the NFC bootloader.
 * See doc/nfc-update-protocol.md §4. WIP scaffold — not yet HW-tested.
 */

#ifndef STICKER_BOOT_ST25DV_MB_H
#define STICKER_BOOT_ST25DV_MB_H

#include <stddef.h>
#include <stdint.h>

/* Power the ST25DV (lpd) and prepare the I2C bus. */
int mb_init(void);

/*
 * Block until the phone has written a request frame (PH_FLAG set), then copy
 * it into `frame` (capacity NFC_MB_REQ_LEN). On success *len is the frame
 * length. Returns 0, or -ETIMEDOUT, or a negative I2C error.
 */
int mb_wait_request(uint8_t *frame, size_t cap, size_t *len, int timeout_ms);

/* Write a response frame, raise MC_FLAG and clear PH_FLAG. */
int mb_send_response(const uint8_t *rsp, size_t len);

#endif /* STICKER_BOOT_ST25DV_MB_H */
```

## src/startup.c
```c
/* Minimal Cortex-M4 startup for the STICKER NFC bootloader.
 *
 * Only the 16 system exception vectors exist: the bootloader runs with PRIMASK
 * set and never takes a peripheral interrupt (a pending interrupt only wakes WFI),
 * so no IRQ vector is ever fetched. Any fault resets the chip. */

#include <stdint.h>

#include "stm32wle5xx.h"

extern uint32_t _sidata, _sdata, _edata, _sbss, _ebss, _estack;

int main(void);
void reset_handler(void);

static void fault_handler(void)
{
	NVIC_SystemReset();
}

__attribute__((section(".vectors"), used)) static void (*const m_vectors[16])(void) = {
	(void (*)(void))&_estack,
	reset_handler,
	fault_handler, /* NMI */
	fault_handler, /* HardFault */
	fault_handler, /* MemManage */
	fault_handler, /* BusFault */
	fault_handler, /* UsageFault */
	0,
	0,
	0,
	0,
	fault_handler, /* SVCall */
	fault_handler, /* DebugMon */
	0,
	fault_handler, /* PendSV */
	fault_handler, /* SysTick */
};

void reset_handler(void)
{
	uint32_t *src = &_sidata;

	for (uint32_t *dst = &_sdata; dst < &_edata;) {
		*dst++ = *src++;
	}
	for (uint32_t *dst = &_sbss; dst < &_ebss;) {
		*dst++ = 0;
	}

	main();

	NVIC_SystemReset();
}
```

## src/verify.c
```c
/*
 * Copyright (c) 2025 HARDWARIO a.s.
 *
 * SPDX-License-Identifier: Apache-2.0
 */

#include "verify.h"

#include <string.h>

bool verify_header(const struct sfu_header *hdr, uint32_t slot_size)
{
	if (hdr->magic[0] != SFU_MAGIC0 || hdr->magic[1] != SFU_MAGIC1 ||
	    hdr->magic[2] != SFU_MAGIC2 || hdr->magic[3] != SFU_MAGIC3) {
		return false;
	}
	if (hdr->hdr_version != SFU_HDR_VERSION) {
		return false;
	}
	if (hdr->payload_len == 0 || hdr->payload_len > slot_size) {
		return false;
	}
	return true;
}
```

## src/verify.h
```c
/*
 * Copyright (c) 2025 HARDWARIO a.s.
 *
 * SPDX-License-Identifier: Apache-2.0
 *
 * Image integrity & authenticity checks for the NFC bootloader.
 * WIP scaffold — signature verification is a stub pending Phase 3.
 */

#ifndef STICKER_BOOT_VERIFY_H
#define STICKER_BOOT_VERIFY_H

#include <sticker/nfc_proto.h>

#include <stdbool.h>
#include <stdint.h>

/* Validate header magic/version/size against the slot. */
bool verify_header(const struct sfu_header *hdr, uint32_t slot_size);

/*
 * Verify the Ed25519 signature over header || payload using the baked-in
 * public key. `payload_crc` is the CRC already computed from the written
 * slot (used to feed the hash without re-reading where possible).
 *
 * TODO(Phase 3): wire a real Ed25519 implementation. Until then this returns
 * true only when CONFIG_BOOT_ALLOW_UNSIGNED is set (DEV/debug builds).
 */
bool verify_signature(const struct sfu_header *hdr,
		      const uint8_t signature[SFU_SIGNATURE_LEN]);

#endif /* STICKER_BOOT_VERIFY_H */
```
