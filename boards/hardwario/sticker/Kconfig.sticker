## boards/hardwario/sticker/Kconfig.sticker
```kconfig
#
# Copyright (c) 2024 HARDWARIO a.s.
#
# SPDX-License-Identifier: Apache-2.0
#

config BOARD_STICKER
	select SOC_STM32WLE5XX
```

## boards/hardwario/sticker/sticker_defconfig
```kconfig
#
# Copyright (c) 2024 HARDWARIO a.s.
#
# SPDX-License-Identifier: Apache-2.0
#

CONFIG_ARM_MPU=y
CONFIG_CLOCK_CONTROL=y
CONFIG_GPIO=y
CONFIG_HW_STACK_PROTECTION=y
CONFIG_PINCTRL=y
```

## drivers/Kconfig
```kconfig
#
# Copyright (c) 2025 HARDWARIO a.s.
#
# SPDX-License-Identifier: Apache-2.0
#

menu "Drivers"

rsource "sensor/Kconfig"
rsource "w1/Kconfig"

endmenu
```

## drivers/sensor/Kconfig
```kconfig
#
# Copyright (c) 2025 HARDWARIO a.s.
#
# SPDX-License-Identifier: Apache-2.0
#

menuconfig SENSOR
	bool "Sensor drivers"
	help
	  Include sensor drivers in system config

if SENSOR

rsource "mpl3115a2/Kconfig"

endif # SENSOR
```

## drivers/sensor/mpl3115a2/Kconfig
```kconfig
#
# Copyright (c) 2025 HARDWARIO a.s.
#
# SPDX-License-Identifier: Apache-2.0
#

menuconfig MPL3115A2
	bool "MPL3115A2 Pressure Sensor"
	depends on I2C
	help
	  Enable the driver for NXP MPL3115A2 Barometric Pressure/Altitude/Temperature Sensor

if MPL3115A2

config MPL3115A2_SHELL
	bool "MPL3115A2 Shell Commands"
	default y
	depends on SHELL

endif # MPL3115A2
```

## drivers/w1/Kconfig
```kconfig
#
# Copyright (c) 2025 HARDWARIO a.s.
#
# SPDX-License-Identifier: Apache-2.0
#

if W1

rsource "Kconfig.ds28e17"

endif # W1
```

## drivers/w1/Kconfig.ds28e17
```kconfig
#
# Copyright (c) 2025 HARDWARIO a.s.
#
# SPDX-License-Identifier: Apache-2.0
#

config DS28E17
	bool "DS28E17 1-Wire-to-I2C Master Bridge"
	default y if $(dt_compat_enabled,$(DT_COMPAT_MAXIM_DS28E17))
	depends on W1_NET
```
