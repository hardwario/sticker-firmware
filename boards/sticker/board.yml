## boards/sticker/board.yml
```yaml
board:
  name: sticker
  full_name: STICKER
  vendor: hardwario
  socs:
    - name: stm32wle5xx
```

## build-tests/Kconfig/Kconfig.modules
```kconfig
menu "sticker (/home/hymbajs/Projects/20_Github/sticker-firmware/sticker-z45/sticker)"
osource "/home/hymbajs/Projects/20_Github/sticker-firmware/sticker-z45/sticker/Kconfig"
config ZEPHYR_STICKER_MODULE
	bool
	default y
endmenu
menu "acpica (/home/hymbajs/Projects/20_Github/sticker-firmware/sticker-z45/modules/lib/acpica)"
osource "$(ZEPHYR_ACPICA_KCONFIG)"
config ZEPHYR_ACPICA_MODULE
	bool
	default y
endmenu
menu "cmsis (/home/hymbajs/Projects/20_Github/sticker-firmware/sticker-z45/modules/hal/cmsis)"
osource "$(ZEPHYR_CMSIS_KCONFIG)"
config ZEPHYR_CMSIS_MODULE
	bool
	default y
endmenu
menu "cmsis-dsp (/home/hymbajs/Projects/20_Github/sticker-firmware/sticker-z45/modules/lib/cmsis-dsp)"
osource "/home/hymbajs/Projects/20_Github/sticker-firmware/sticker-z45/modules/lib/cmsis-dsp/zephyr/Kconfig"
config ZEPHYR_CMSIS_DSP_MODULE
	bool
	default y
endmenu
menu "cmsis-nn (/home/hymbajs/Projects/20_Github/sticker-firmware/sticker-z45/modules/lib/cmsis-nn)"
osource "$(ZEPHYR_CMSIS_NN_KCONFIG)"
config ZEPHYR_CMSIS_NN_MODULE
	bool
	default y
endmenu
menu "cmsis_6 (/home/hymbajs/Projects/20_Github/sticker-firmware/sticker-z45/modules/hal/cmsis_6)"
osource "$(ZEPHYR_CMSIS_6_KCONFIG)"
config ZEPHYR_CMSIS_6_MODULE
	bool
	default y
endmenu
menu "dhara (/home/hymbajs/Projects/20_Github/sticker-firmware/sticker-z45/modules/lib/dhara)"
osource "$(ZEPHYR_DHARA_KCONFIG)"
config ZEPHYR_DHARA_MODULE
	bool
	default y
endmenu
menu "fatfs (/home/hymbajs/Projects/20_Github/sticker-firmware/sticker-z45/modules/fs/fatfs)"
osource "$(ZEPHYR_FATFS_KCONFIG)"
config ZEPHYR_FATFS_MODULE
	bool
	default y
endmenu
config ZEPHYR_ADI_MODULE
	bool
	default y
menu "hal_afbr (/home/hymbajs/Projects/20_Github/sticker-firmware/sticker-z45/modules/hal/afbr)"
osource "$(ZEPHYR_HAL_AFBR_KCONFIG)"
config ZEPHYR_HAL_AFBR_MODULE
	bool
	default y

config ZEPHYR_HAL_AFBR_MODULE_BLOBS
	bool
endmenu
menu "hal_ambiq (/home/hymbajs/Projects/20_Github/sticker-firmware/sticker-z45/modules/hal/ambiq)"
osource "$(ZEPHYR_HAL_AMBIQ_KCONFIG)"
config ZEPHYR_HAL_AMBIQ_MODULE
	bool
	default y
endmenu
config ZEPHYR_ATMEL_MODULE
	bool
	default y
menu "hal_bouffalolab (/home/hymbajs/Projects/20_Github/sticker-firmware/sticker-z45/modules/hal/bouffalolab)"
osource "$(ZEPHYR_HAL_BOUFFALOLAB_KCONFIG)"
config ZEPHYR_HAL_BOUFFALOLAB_MODULE
	bool
	default y

config ZEPHYR_HAL_BOUFFALOLAB_MODULE_BLOBS
	bool
endmenu
menu "hal_espressif (/home/hymbajs/Projects/20_Github/sticker-firmware/sticker-z45/modules/hal/espressif)"
osource "/home/hymbajs/Projects/20_Github/sticker-firmware/sticker-z45/modules/hal/espressif/zephyr/Kconfig"
config ZEPHYR_HAL_ESPRESSIF_MODULE
	bool
	default y

config ZEPHYR_HAL_ESPRESSIF_MODULE_BLOBS
	bool
endmenu
menu "hal_ethos_u (/home/hymbajs/Projects/20_Github/sticker-firmware/sticker-z45/modules/hal/ethos_u)"
osource "$(ZEPHYR_HAL_ETHOS_U_KCONFIG)"
config ZEPHYR_HAL_ETHOS_U_MODULE
	bool
	default y
endmenu
menu "hal_gigadevice (/home/hymbajs/Projects/20_Github/sticker-firmware/sticker-z45/modules/hal/gigadevice)"
osource "$(ZEPHYR_HAL_GIGADEVICE_KCONFIG)"
config ZEPHYR_HAL_GIGADEVICE_MODULE
	bool
	default y
endmenu
menu "hal_infineon (/home/hymbajs/Projects/20_Github/sticker-firmware/sticker-z45/modules/hal/infineon)"
osource "$(ZEPHYR_HAL_INFINEON_KCONFIG)"
config ZEPHYR_HAL_INFINEON_MODULE
	bool
	default y

config ZEPHYR_HAL_INFINEON_MODULE_BLOBS
	bool
endmenu
menu "hal_intel (/home/hymbajs/Projects/20_Github/sticker-firmware/sticker-z45/modules/hal/intel)"
osource "/home/hymbajs/Projects/20_Github/sticker-firmware/sticker-z45/modules/hal/intel/zephyr/Kconfig"
config ZEPHYR_HAL_INTEL_MODULE
	bool
	default y
endmenu
config ZEPHYR_HAL_MICROCHIP_MODULE
	bool
	default y

config ZEPHYR_HAL_MICROCHIP_MODULE_BLOBS
	bool
menu "hal_nordic (/home/hymbajs/Projects/20_Github/sticker-firmware/sticker-z45/modules/hal/nordic)"
osource "$(ZEPHYR_HAL_NORDIC_KCONFIG)"
config ZEPHYR_HAL_NORDIC_MODULE
	bool
	default y

config ZEPHYR_HAL_NORDIC_MODULE_BLOBS
	bool
endmenu
config ZEPHYR_NUVOTON_MODULE
	bool
	default y
menu "hal_nxp (/home/hymbajs/Projects/20_Github/sticker-firmware/sticker-z45/modules/hal/nxp)"
osource "$(ZEPHYR_HAL_NXP_KCONFIG)"
config ZEPHYR_HAL_NXP_MODULE
	bool
	default y

config ZEPHYR_HAL_NXP_MODULE_BLOBS
	bool
endmenu
config ZEPHYR_OPENISA_MODULE
	bool
	default y
config ZEPHYR_QUICKLOGIC_MODULE
	bool
	default y
menu "hal_realtek (/home/hymbajs/Projects/20_Github/sticker-firmware/sticker-z45/modules/hal/realtek)"
osource "$(ZEPHYR_HAL_REALTEK_KCONFIG)"
config ZEPHYR_HAL_REALTEK_MODULE
	bool
	default y

config ZEPHYR_HAL_REALTEK_MODULE_BLOBS
	bool
endmenu
config ZEPHYR_HAL_RENESAS_MODULE
	bool
	default y

config ZEPHYR_HAL_RENESAS_MODULE_BLOBS
	bool
menu "hal_rpi_pico (/home/hymbajs/Projects/20_Github/sticker-firmware/sticker-z45/modules/hal/rpi_pico)"
osource "$(ZEPHYR_HAL_RPI_PICO_KCONFIG)"
config ZEPHYR_HAL_RPI_PICO_MODULE
	bool
	default y
endmenu
menu "hal_sifli (/home/hymbajs/Projects/20_Github/sticker-firmware/sticker-z45/modules/hal/sifli)"
osource "$(ZEPHYR_HAL_SIFLI_KCONFIG)"
config ZEPHYR_HAL_SIFLI_MODULE
	bool
	default y

config ZEPHYR_HAL_SIFLI_MODULE_BLOBS
	bool
endmenu
menu "hal_silabs (/home/hymbajs/Projects/20_Github/sticker-firmware/sticker-z45/modules/hal/silabs)"
osource "$(ZEPHYR_HAL_SILABS_KCONFIG)"
config ZEPHYR_HAL_SILABS_MODULE
	bool
	default y

config ZEPHYR_HAL_SILABS_MODULE_BLOBS
	bool
endmenu
menu "hal_st (/home/hymbajs/Projects/20_Github/sticker-firmware/sticker-z45/modules/hal/st)"
osource "$(ZEPHYR_HAL_ST_KCONFIG)"
config ZEPHYR_HAL_ST_MODULE
	bool
	default y

config ZEPHYR_HAL_ST_MODULE_BLOBS
	bool
endmenu
config ZEPHYR_HAL_STM32_MODULE
	bool
	default y

config ZEPHYR_HAL_STM32_MODULE_BLOBS
	bool
menu "hal_tdk (/home/hymbajs/Projects/20_Github/sticker-firmware/sticker-z45/modules/hal/tdk)"
osource "$(ZEPHYR_HAL_TDK_KCONFIG)"
config ZEPHYR_HAL_TDK_MODULE
	bool
	default y
endmenu
menu "hal_telink (/home/hymbajs/Projects/20_Github/sticker-firmware/sticker-z45/modules/hal/telink)"
osource "/home/hymbajs/Projects/20_Github/sticker-firmware/sticker-z45/modules/hal/telink/Kconfig"
config ZEPHYR_HAL_TELINK_MODULE
	bool
	default y
endmenu
config ZEPHYR_TI_MODULE
	bool
	default y
menu "hal_wch (/home/hymbajs/Projects/20_Github/sticker-firmware/sticker-z45/modules/hal/wch)"
osource "$(ZEPHYR_HAL_WCH_KCONFIG)"
config ZEPHYR_HAL_WCH_MODULE
	bool
	default y
endmenu
config ZEPHYR_HAL_WURTHELEKTRONIK_MODULE
	bool
	default y
config ZEPHYR_XTENSA_MODULE
	bool
	default y
menu "hostap (/home/hymbajs/Projects/20_Github/sticker-firmware/sticker-z45/modules/lib/hostap)"
osource "$(ZEPHYR_HOSTAP_KCONFIG)"
config ZEPHYR_HOSTAP_MODULE
	bool
	default y
endmenu
menu "liblc3 (/home/hymbajs/Projects/20_Github/sticker-firmware/sticker-z45/modules/lib/liblc3)"
osource "$(ZEPHYR_LIBLC3_KCONFIG)"
config ZEPHYR_LIBLC3_MODULE
	bool
	default y
endmenu
config ZEPHYR_LIBMCTP_MODULE
	bool
	default y
config ZEPHYR_LIBMETAL_MODULE
	bool
	default y
menu "libsbc (/home/hymbajs/Projects/20_Github/sticker-firmware/sticker-z45/modules/lib/libsbc)"
osource "$(ZEPHYR_LIBSBC_KCONFIG)"
config ZEPHYR_LIBSBC_MODULE
	bool
	default y
endmenu
menu "littlefs (/home/hymbajs/Projects/20_Github/sticker-firmware/sticker-z45/modules/fs/littlefs)"
osource "$(ZEPHYR_LITTLEFS_KCONFIG)"
config ZEPHYR_LITTLEFS_MODULE
	bool
	default y
endmenu
menu "lora-basics-modem (/home/hymbajs/Projects/20_Github/sticker-firmware/sticker-z45/modules/lib/lora-basics-modem)"
osource "$(ZEPHYR_LORA_BASICS_MODEM_KCONFIG)"
config ZEPHYR_LORA_BASICS_MODEM_MODULE
	bool
	default y
endmenu
menu "loramac-node (/home/hymbajs/Projects/20_Github/sticker-firmware/sticker-z45/modules/lib/loramac-node)"
osource "$(ZEPHYR_LORAMAC_NODE_KCONFIG)"
config ZEPHYR_LORAMAC_NODE_MODULE
	bool
	default y
endmenu
menu "lvgl (/home/hymbajs/Projects/20_Github/sticker-firmware/sticker-z45/modules/lib/gui/lvgl)"
osource "/home/hymbajs/Projects/20_Github/sticker-firmware/sticker-z45/modules/lib/gui/lvgl/zephyr/Kconfig"
config ZEPHYR_LVGL_MODULE
	bool
	default y
endmenu
menu "mbedtls (/home/hymbajs/Projects/20_Github/sticker-firmware/sticker-z45/modules/crypto/mbedtls)"
osource "$(ZEPHYR_MBEDTLS_KCONFIG)"
config ZEPHYR_MBEDTLS_MODULE
	bool
	default y
endmenu
config ZEPHYR_MCUBOOT_MODULE
	bool
	default y
config ZEPHYR_MIPI_SYS_T_MODULE
	bool
	default y
config ZEPHYR_MLDSA_NATIVE_MODULE
	bool
	default y
menu "nanopb (/home/hymbajs/Projects/20_Github/sticker-firmware/sticker-z45/modules/lib/nanopb)"
osource "$(ZEPHYR_NANOPB_KCONFIG)"
config ZEPHYR_NANOPB_MODULE
	bool
	default y
endmenu
menu "nrf_wifi (/home/hymbajs/Projects/20_Github/sticker-firmware/sticker-z45/modules/lib/nrf_wifi)"
osource "$(ZEPHYR_NRF_WIFI_KCONFIG)"
config ZEPHYR_NRF_WIFI_MODULE
	bool
	default y

config ZEPHYR_NRF_WIFI_MODULE_BLOBS
	bool
endmenu
config ZEPHYR_OPEN_AMP_MODULE
	bool
	default y
menu "openthread (/home/hymbajs/Projects/20_Github/sticker-firmware/sticker-z45/modules/lib/openthread)"
osource "$(ZEPHYR_OPENTHREAD_KCONFIG)"
config ZEPHYR_OPENTHREAD_MODULE
	bool
	default y
endmenu
menu "percepio (/home/hymbajs/Projects/20_Github/sticker-firmware/sticker-z45/modules/debug/percepio)"
osource "/home/hymbajs/Projects/20_Github/sticker-firmware/sticker-z45/modules/debug/percepio/zephyr/Kconfig"
config ZEPHYR_PERCEPIO_MODULE
	bool
	default y
endmenu
menu "picolibc (/home/hymbajs/Projects/20_Github/sticker-firmware/sticker-z45/modules/lib/picolibc)"
osource "/home/hymbajs/Projects/20_Github/sticker-firmware/sticker-z45/modules/lib/picolibc/zephyr/Kconfig"
config ZEPHYR_PICOLIBC_MODULE
	bool
	default y
endmenu
config ZEPHYR_PSA_ARCH_TESTS_MODULE
	bool
	default y
config ZEPHYR_REQMGMT_MODULE
	bool
	default y
menu "segger (/home/hymbajs/Projects/20_Github/sticker-firmware/sticker-z45/modules/debug/segger)"
osource "$(ZEPHYR_SEGGER_KCONFIG)"
config ZEPHYR_SEGGER_MODULE
	bool
	default y
endmenu
config ZEPHYR_TF_M_TESTS_MODULE
	bool
	default y
config ZEPHYR_TF_PSA_CRYPTO_MODULE
	bool
	default y
config ZEPHYR_TF_PSA_CRYPTO_DRIVERS_MODULE
	bool
	default y
menu "trusted-firmware-a (/home/hymbajs/Projects/20_Github/sticker-firmware/sticker-z45/modules/tee/tf-a/trusted-firmware-a)"
osource "$(ZEPHYR_TRUSTED_FIRMWARE_A_KCONFIG)"
config ZEPHYR_TRUSTED_FIRMWARE_A_MODULE
	bool
	default y
endmenu
menu "trusted-firmware-m (/home/hymbajs/Projects/20_Github/sticker-firmware/sticker-z45/modules/tee/tf-m/trusted-firmware-m)"
osource "$(ZEPHYR_TRUSTED_FIRMWARE_M_KCONFIG)"
config ZEPHYR_TRUSTED_FIRMWARE_M_MODULE
	bool
	default y
endmenu
menu "uoscore-uedhoc (/home/hymbajs/Projects/20_Github/sticker-firmware/sticker-z45/modules/lib/uoscore-uedhoc)"
osource "$(ZEPHYR_UOSCORE_UEDHOC_KCONFIG)"
config ZEPHYR_UOSCORE_UEDHOC_MODULE
	bool
	default y
endmenu
menu "zcbor (/home/hymbajs/Projects/20_Github/sticker-firmware/sticker-z45/modules/lib/zcbor)"
osource "$(ZEPHYR_ZCBOR_KCONFIG)"
config ZEPHYR_ZCBOR_MODULE
	bool
	default y
endmenu
menu "xenlib (/home/hymbajs/Projects/20_Github/sticker-firmware/sticker-z45/modules/lib/zephyr-xenlib)"
osource "/home/hymbajs/Projects/20_Github/sticker-firmware/sticker-z45/modules/lib/zephyr-xenlib/Kconfig"
config ZEPHYR_XENLIB_MODULE
	bool
	default y
endmenu
config ZEPHYR_NRF_HW_MODELS_MODULE
	bool
	default y
```

## build-tests/Kconfig/Kconfig.shield
```kconfig
osource "/home/hymbajs/Projects/20_Github/sticker-firmware/sticker-z45/sticker/boards/shields/*/Kconfig.shield"
```

## build-tests/Kconfig/arch/Kconfig
```kconfig
# Load Zephyr Arch Kconfig descriptions.
osource "/home/hymbajs/Projects/20_Github/sticker-firmware/sticker-z45/zephyr/arch/tricore/Kconfig"
osource "/home/hymbajs/Projects/20_Github/sticker-firmware/sticker-z45/zephyr/arch/hexagon/Kconfig"
osource "/home/hymbajs/Projects/20_Github/sticker-firmware/sticker-z45/zephyr/arch/rx/Kconfig"
osource "/home/hymbajs/Projects/20_Github/sticker-firmware/sticker-z45/zephyr/arch/x86/Kconfig"
osource "/home/hymbajs/Projects/20_Github/sticker-firmware/sticker-z45/zephyr/arch/xtensa/Kconfig"
osource "/home/hymbajs/Projects/20_Github/sticker-firmware/sticker-z45/zephyr/arch/sparc/Kconfig"
osource "/home/hymbajs/Projects/20_Github/sticker-firmware/sticker-z45/zephyr/arch/riscv/Kconfig"
osource "/home/hymbajs/Projects/20_Github/sticker-firmware/sticker-z45/zephyr/arch/posix/Kconfig"
osource "/home/hymbajs/Projects/20_Github/sticker-firmware/sticker-z45/zephyr/arch/openrisc/Kconfig"
osource "/home/hymbajs/Projects/20_Github/sticker-firmware/sticker-z45/zephyr/arch/mips/Kconfig"
osource "/home/hymbajs/Projects/20_Github/sticker-firmware/sticker-z45/zephyr/arch/arm64/Kconfig"
osource "/home/hymbajs/Projects/20_Github/sticker-firmware/sticker-z45/zephyr/arch/arm/Kconfig"
osource "/home/hymbajs/Projects/20_Github/sticker-firmware/sticker-z45/zephyr/arch/arc/Kconfig"
```

## build-tests/Kconfig/boards/Kconfig.defconfig
```kconfig
# Load Zephyr board defconfig descriptions.
osource "/home/hymbajs/Projects/20_Github/sticker-firmware/sticker-z45/zephyr/boards/native/native_sim/Kconfig.defconfig"
```

## build-tests/Kconfig/boards/Kconfig.sysbuild
```kconfig
# Load Sysbuild board Kconfig descriptions.
osource "/home/hymbajs/Projects/20_Github/sticker-firmware/sticker-z45/zephyr/boards/native/native_sim/Kconfig.sysbuild"
```
