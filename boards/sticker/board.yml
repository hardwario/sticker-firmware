## build-tests/Kconfig/soc/Kconfig
```kconfig
# Load Zephyr SoC Kconfig descriptions.
osource "/home/hymbajs/Projects/20_Github/sticker-firmware/sticker-z45/zephyr/soc/xlnx/zynqmp/Kconfig"
osource "/home/hymbajs/Projects/20_Github/sticker-firmware/sticker-z45/zephyr/soc/xlnx/zynq7000/Kconfig"
osource "/home/hymbajs/Projects/20_Github/sticker-firmware/sticker-z45/zephyr/soc/xlnx/versalnet/Kconfig"
osource "/home/hymbajs/Projects/20_Github/sticker-firmware/sticker-z45/zephyr/soc/xlnx/versal2/Kconfig"
osource "/home/hymbajs/Projects/20_Github/sticker-firmware/sticker-z45/zephyr/soc/xlnx/versal/Kconfig"
osource "/home/hymbajs/Projects/20_Github/sticker-firmware/sticker-z45/zephyr/soc/xen/Kconfig"
osource "/home/hymbajs/Projects/20_Github/sticker-firmware/sticker-z45/zephyr/soc/wch/ch32v/Kconfig"
osource "/home/hymbajs/Projects/20_Github/sticker-firmware/sticker-z45/zephyr/soc/ti/tiva_c/Kconfig"
osource "/home/hymbajs/Projects/20_Github/sticker-firmware/sticker-z45/zephyr/soc/ti/simplelink/Kconfig"
osource "/home/hymbajs/Projects/20_Github/sticker-firmware/sticker-z45/zephyr/soc/ti/mspm/Kconfig"
osource "/home/hymbajs/Projects/20_Github/sticker-firmware/sticker-z45/zephyr/soc/ti/lm3s6965/Kconfig"
osource "/home/hymbajs/Projects/20_Github/sticker-firmware/sticker-z45/zephyr/soc/ti/k3/Kconfig"
osource "/home/hymbajs/Projects/20_Github/sticker-firmware/sticker-z45/zephyr/soc/ti/am13/Kconfig"
osource "/home/hymbajs/Projects/20_Github/sticker-firmware/sticker-z45/zephyr/soc/telink/tlsr/Kconfig"
osource "/home/hymbajs/Projects/20_Github/sticker-firmware/sticker-z45/zephyr/soc/syna/sr100/Kconfig"
osource "/home/hymbajs/Projects/20_Github/sticker-firmware/sticker-z45/zephyr/soc/starfive/jh71xx/Kconfig"
osource "/home/hymbajs/Projects/20_Github/sticker-firmware/sticker-z45/zephyr/soc/st/stm32/Kconfig"
osource "/home/hymbajs/Projects/20_Github/sticker-firmware/sticker-z45/zephyr/soc/snps/qemu_arc/Kconfig"
osource "/home/hymbajs/Projects/20_Github/sticker-firmware/sticker-z45/zephyr/soc/snps/nsim/arc_v/Kconfig"
osource "/home/hymbajs/Projects/20_Github/sticker-firmware/sticker-z45/zephyr/soc/snps/nsim/arc_classic/Kconfig"
osource "/home/hymbajs/Projects/20_Github/sticker-firmware/sticker-z45/zephyr/soc/snps/hsdk4xd/Kconfig"
osource "/home/hymbajs/Projects/20_Github/sticker-firmware/sticker-z45/zephyr/soc/snps/hsdk/Kconfig"
osource "/home/hymbajs/Projects/20_Github/sticker-firmware/sticker-z45/zephyr/soc/snps/emsk/Kconfig"
osource "/home/hymbajs/Projects/20_Github/sticker-firmware/sticker-z45/zephyr/soc/snps/emsdp/Kconfig"
osource "/home/hymbajs/Projects/20_Github/sticker-firmware/sticker-z45/zephyr/soc/snps/arc_iot/Kconfig"
osource "/home/hymbajs/Projects/20_Github/sticker-firmware/sticker-z45/zephyr/soc/silabs/Kconfig"
osource "/home/hymbajs/Projects/20_Github/sticker-firmware/sticker-z45/zephyr/soc/sifli/sf32/Kconfig"
osource "/home/hymbajs/Projects/20_Github/sticker-firmware/sticker-z45/zephyr/soc/sifive/sifive_freedom/Kconfig"
osource "/home/hymbajs/Projects/20_Github/sticker-firmware/sticker-z45/zephyr/soc/shakti/Kconfig"
osource "/home/hymbajs/Projects/20_Github/sticker-firmware/sticker-z45/zephyr/soc/sensry/Kconfig"
osource "/home/hymbajs/Projects/20_Github/sticker-firmware/sticker-z45/zephyr/soc/rockchip/Kconfig"
osource "/home/hymbajs/Projects/20_Github/sticker-firmware/sticker-z45/zephyr/soc/renode/riscv_virtual/Kconfig"
osource "/home/hymbajs/Projects/20_Github/sticker-firmware/sticker-z45/zephyr/soc/renode/cortex_r8_virtual/Kconfig"
osource "/home/hymbajs/Projects/20_Github/sticker-firmware/sticker-z45/zephyr/soc/renesas/smartbond/Kconfig"
osource "/home/hymbajs/Projects/20_Github/sticker-firmware/sticker-z45/zephyr/soc/renesas/rz/Kconfig"
osource "/home/hymbajs/Projects/20_Github/sticker-firmware/sticker-z45/zephyr/soc/renesas/rx/Kconfig"
osource "/home/hymbajs/Projects/20_Github/sticker-firmware/sticker-z45/zephyr/soc/renesas/rcar/Kconfig"
osource "/home/hymbajs/Projects/20_Github/sticker-firmware/sticker-z45/zephyr/soc/renesas/ra/Kconfig"
osource "/home/hymbajs/Projects/20_Github/sticker-firmware/sticker-z45/zephyr/soc/realtek/fingerprint/Kconfig"
osource "/home/hymbajs/Projects/20_Github/sticker-firmware/sticker-z45/zephyr/soc/realtek/ec/Kconfig"
osource "/home/hymbajs/Projects/20_Github/sticker-firmware/sticker-z45/zephyr/soc/realtek/bee/Kconfig"
osource "/home/hymbajs/Projects/20_Github/sticker-firmware/sticker-z45/zephyr/soc/realtek/ameba/Kconfig"
osource "/home/hymbajs/Projects/20_Github/sticker-firmware/sticker-z45/zephyr/soc/raspberrypi/rpi_pico/Kconfig"
osource "/home/hymbajs/Projects/20_Github/sticker-firmware/sticker-z45/zephyr/soc/quicklogic/eos_s3/Kconfig"
osource "/home/hymbajs/Projects/20_Github/sticker-firmware/sticker-z45/zephyr/soc/qemu/virt_riscv/Kconfig"
osource "/home/hymbajs/Projects/20_Github/sticker-firmware/sticker-z45/zephyr/soc/qemu/tricore/Kconfig"
osource "/home/hymbajs/Projects/20_Github/sticker-firmware/sticker-z45/zephyr/soc/qemu/or1k/Kconfig"
osource "/home/hymbajs/Projects/20_Github/sticker-firmware/sticker-z45/zephyr/soc/qemu/malta/Kconfig"
osource "/home/hymbajs/Projects/20_Github/sticker-firmware/sticker-z45/zephyr/soc/qemu/hexagon/Kconfig"
osource "/home/hymbajs/Projects/20_Github/sticker-firmware/sticker-z45/zephyr/soc/openisa/rv32m1/Kconfig"
osource "/home/hymbajs/Projects/20_Github/sticker-firmware/sticker-z45/zephyr/soc/openhwgroup/cva6/Kconfig"
osource "/home/hymbajs/Projects/20_Github/sticker-firmware/sticker-z45/zephyr/soc/oct/osd32mp15x/Kconfig"
osource "/home/hymbajs/Projects/20_Github/sticker-firmware/sticker-z45/zephyr/soc/nxp/s32/Kconfig"
osource "/home/hymbajs/Projects/20_Github/sticker-firmware/sticker-z45/zephyr/soc/nxp/rw/Kconfig"
osource "/home/hymbajs/Projects/20_Github/sticker-firmware/sticker-z45/zephyr/soc/nxp/mcx/Kconfig"
osource "/home/hymbajs/Projects/20_Github/sticker-firmware/sticker-z45/zephyr/soc/nxp/lpc/Kconfig"
osource "/home/hymbajs/Projects/20_Github/sticker-firmware/sticker-z45/zephyr/soc/nxp/layerscape/Kconfig"
osource "/home/hymbajs/Projects/20_Github/sticker-firmware/sticker-z45/zephyr/soc/nxp/kinetis/Kconfig"
osource "/home/hymbajs/Projects/20_Github/sticker-firmware/sticker-z45/zephyr/soc/nxp/imxrt/Kconfig"
osource "/home/hymbajs/Projects/20_Github/sticker-firmware/sticker-z45/zephyr/soc/nxp/imx/Kconfig"
osource "/home/hymbajs/Projects/20_Github/sticker-firmware/sticker-z45/zephyr/soc/nuvoton/numicro/Kconfig"
osource "/home/hymbajs/Projects/20_Github/sticker-firmware/sticker-z45/zephyr/soc/nuvoton/numaker/Kconfig"
osource "/home/hymbajs/Projects/20_Github/sticker-firmware/sticker-z45/zephyr/soc/nuvoton/npcx/Kconfig"
osource "/home/hymbajs/Projects/20_Github/sticker-firmware/sticker-z45/zephyr/soc/nuvoton/npcm/Kconfig"
osource "/home/hymbajs/Projects/20_Github/sticker-firmware/sticker-z45/zephyr/soc/nordic/Kconfig"
osource "/home/hymbajs/Projects/20_Github/sticker-firmware/sticker-z45/zephyr/soc/neorv32/Kconfig"
osource "/home/hymbajs/Projects/20_Github/sticker-firmware/sticker-z45/zephyr/soc/native/inf_clock/Kconfig"
osource "/home/hymbajs/Projects/20_Github/sticker-firmware/sticker-z45/zephyr/soc/microchip/smartfusion2/Kconfig"
osource "/home/hymbajs/Projects/20_Github/sticker-firmware/sticker-z45/zephyr/soc/microchip/sam/sama7/Kconfig"
osource "/home/hymbajs/Projects/20_Github/sticker-firmware/sticker-z45/zephyr/soc/microchip/sam/sama5/Kconfig"
osource "/home/hymbajs/Projects/20_Github/sticker-firmware/sticker-z45/zephyr/soc/microchip/sam/sam_d5x_e5x/Kconfig"
osource "/home/hymbajs/Projects/20_Github/sticker-firmware/sticker-z45/zephyr/soc/microchip/pic64/Kconfig"
osource "/home/hymbajs/Projects/20_Github/sticker-firmware/sticker-z45/zephyr/soc/microchip/pic32c/pic32cz_ca/Kconfig"
osource "/home/hymbajs/Projects/20_Github/sticker-firmware/sticker-z45/zephyr/soc/microchip/pic32c/pic32cx_sg/Kconfig"
osource "/home/hymbajs/Projects/20_Github/sticker-firmware/sticker-z45/zephyr/soc/microchip/pic32c/pic32cm_sg_gc/Kconfig"
osource "/home/hymbajs/Projects/20_Github/sticker-firmware/sticker-z45/zephyr/soc/microchip/pic32c/pic32cm_pl/Kconfig"
osource "/home/hymbajs/Projects/20_Github/sticker-firmware/sticker-z45/zephyr/soc/microchip/pic32c/pic32cm_jh/Kconfig"
osource "/home/hymbajs/Projects/20_Github/sticker-firmware/sticker-z45/zephyr/soc/microchip/pic32c/pic32ck_sg_gc/Kconfig"
osource "/home/hymbajs/Projects/20_Github/sticker-firmware/sticker-z45/zephyr/soc/microchip/miv/Kconfig"
osource "/home/hymbajs/Projects/20_Github/sticker-firmware/sticker-z45/zephyr/soc/microchip/mec/Kconfig"
osource "/home/hymbajs/Projects/20_Github/sticker-firmware/sticker-z45/zephyr/soc/mediatek/mt8xxx/Kconfig"
osource "/home/hymbajs/Projects/20_Github/sticker-firmware/sticker-z45/zephyr/soc/lowrisc/opentitan/Kconfig"
osource "/home/hymbajs/Projects/20_Github/sticker-firmware/sticker-z45/zephyr/soc/litex/Kconfig"
osource "/home/hymbajs/Projects/20_Github/sticker-firmware/sticker-z45/zephyr/soc/ite/ec/Kconfig"
osource "/home/hymbajs/Projects/20_Github/sticker-firmware/sticker-z45/zephyr/soc/intel/wildcat_lake/Kconfig"
osource "/home/hymbajs/Projects/20_Github/sticker-firmware/sticker-z45/zephyr/soc/intel/raptor_lake/Kconfig"
osource "/home/hymbajs/Projects/20_Github/sticker-firmware/sticker-z45/zephyr/soc/intel/panther_lake/Kconfig"
osource "/home/hymbajs/Projects/20_Github/sticker-firmware/sticker-z45/zephyr/soc/intel/nova_lake/Kconfig"
osource "/home/hymbajs/Projects/20_Github/sticker-firmware/sticker-z45/zephyr/soc/intel/lakemont/Kconfig"
osource "/home/hymbajs/Projects/20_Github/sticker-firmware/sticker-z45/zephyr/soc/intel/intel_socfpga_std/Kconfig"
osource "/home/hymbajs/Projects/20_Github/sticker-firmware/sticker-z45/zephyr/soc/intel/intel_socfpga/Kconfig"
osource "/home/hymbajs/Projects/20_Github/sticker-firmware/sticker-z45/zephyr/soc/intel/intel_niosv/Kconfig"
osource "/home/hymbajs/Projects/20_Github/sticker-firmware/sticker-z45/zephyr/soc/intel/intel_ish/Kconfig"
osource "/home/hymbajs/Projects/20_Github/sticker-firmware/sticker-z45/zephyr/soc/intel/intel_adsp/Kconfig"
osource "/home/hymbajs/Projects/20_Github/sticker-firmware/sticker-z45/zephyr/soc/intel/elkhart_lake/Kconfig"
osource "/home/hymbajs/Projects/20_Github/sticker-firmware/sticker-z45/zephyr/soc/intel/atom/Kconfig"
osource "/home/hymbajs/Projects/20_Github/sticker-firmware/sticker-z45/zephyr/soc/intel/apollo_lake/Kconfig"
osource "/home/hymbajs/Projects/20_Github/sticker-firmware/sticker-z45/zephyr/soc/intel/alder_lake/Kconfig"
osource "/home/hymbajs/Projects/20_Github/sticker-firmware/sticker-z45/zephyr/soc/infineon/psoc4/Kconfig"
osource "/home/hymbajs/Projects/20_Github/sticker-firmware/sticker-z45/zephyr/soc/infineon/edge/Kconfig"
osource "/home/hymbajs/Projects/20_Github/sticker-firmware/sticker-z45/zephyr/soc/infineon/cat3/Kconfig"
osource "/home/hymbajs/Projects/20_Github/sticker-firmware/sticker-z45/zephyr/soc/infineon/cat1c/Kconfig"
osource "/home/hymbajs/Projects/20_Github/sticker-firmware/sticker-z45/zephyr/soc/infineon/cat1b/Kconfig"
osource "/home/hymbajs/Projects/20_Github/sticker-firmware/sticker-z45/zephyr/soc/infineon/cat1a/Kconfig"
osource "/home/hymbajs/Projects/20_Github/sticker-firmware/sticker-z45/zephyr/soc/gd/gd32/Kconfig"
osource "/home/hymbajs/Projects/20_Github/sticker-firmware/sticker-z45/zephyr/soc/gaisler/leon3/Kconfig"
osource "/home/hymbajs/Projects/20_Github/sticker-firmware/sticker-z45/zephyr/soc/gaisler/gr716a/Kconfig"
osource "/home/hymbajs/Projects/20_Github/sticker-firmware/sticker-z45/zephyr/soc/focaltech/Kconfig"
osource "/home/hymbajs/Projects/20_Github/sticker-firmware/sticker-z45/zephyr/soc/espressif/Kconfig"
osource "/home/hymbajs/Projects/20_Github/sticker-firmware/sticker-z45/zephyr/soc/ene/kb1200/Kconfig"
osource "/home/hymbajs/Projects/20_Github/sticker-firmware/sticker-z45/zephyr/soc/ene/kb106x/Kconfig"
osource "/home/hymbajs/Projects/20_Github/sticker-firmware/sticker-z45/zephyr/soc/elan/em32f967/Kconfig"
osource "/home/hymbajs/Projects/20_Github/sticker-firmware/sticker-z45/zephyr/soc/egis/Kconfig"
osource "/home/hymbajs/Projects/20_Github/sticker-firmware/sticker-z45/zephyr/soc/efinix/sapphire/Kconfig"
osource "/home/hymbajs/Projects/20_Github/sticker-firmware/sticker-z45/zephyr/soc/cdns/xtensa_sample_controller/Kconfig"
osource "/home/hymbajs/Projects/20_Github/sticker-firmware/sticker-z45/zephyr/soc/cdns/swerv/Kconfig"
osource "/home/hymbajs/Projects/20_Github/sticker-firmware/sticker-z45/zephyr/soc/cdns/sample_controller32/Kconfig"
osource "/home/hymbajs/Projects/20_Github/sticker-firmware/sticker-z45/zephyr/soc/cdns/dc233c/Kconfig"
osource "/home/hymbajs/Projects/20_Github/sticker-firmware/sticker-z45/zephyr/soc/cdac/Kconfig"
osource "/home/hymbajs/Projects/20_Github/sticker-firmware/sticker-z45/zephyr/soc/brcm/bcmvk/Kconfig"
osource "/home/hymbajs/Projects/20_Github/sticker-firmware/sticker-z45/zephyr/soc/brcm/bcm2712/Kconfig"
osource "/home/hymbajs/Projects/20_Github/sticker-firmware/sticker-z45/zephyr/soc/brcm/bcm2711/Kconfig"
osource "/home/hymbajs/Projects/20_Github/sticker-firmware/sticker-z45/zephyr/soc/brcm/bcm2710/Kconfig"
osource "/home/hymbajs/Projects/20_Github/sticker-firmware/sticker-z45/zephyr/soc/blackberry/qnxhv_vm/Kconfig"
osource "/home/hymbajs/Projects/20_Github/sticker-firmware/sticker-z45/zephyr/soc/bflb/Kconfig"
osource "/home/hymbajs/Projects/20_Github/sticker-firmware/sticker-z45/zephyr/soc/atmel/sam0/Kconfig"
osource "/home/hymbajs/Projects/20_Github/sticker-firmware/sticker-z45/zephyr/soc/atmel/sam/Kconfig"
osource "/home/hymbajs/Projects/20_Github/sticker-firmware/sticker-z45/zephyr/soc/aspeed/Kconfig"
osource "/home/hymbajs/Projects/20_Github/sticker-firmware/sticker-z45/zephyr/soc/arm/Kconfig"
osource "/home/hymbajs/Projects/20_Github/sticker-firmware/sticker-z45/zephyr/soc/antmicro/myra/Kconfig"
osource "/home/hymbajs/Projects/20_Github/sticker-firmware/sticker-z45/zephyr/soc/andestech/Kconfig"
osource "/home/hymbajs/Projects/20_Github/sticker-firmware/sticker-z45/zephyr/soc/amd/acp_7_x/Kconfig"
osource "/home/hymbajs/Projects/20_Github/sticker-firmware/sticker-z45/zephyr/soc/amd/acp_7_0/Kconfig"
osource "/home/hymbajs/Projects/20_Github/sticker-firmware/sticker-z45/zephyr/soc/amd/acp_6_0/Kconfig"
osource "/home/hymbajs/Projects/20_Github/sticker-firmware/sticker-z45/zephyr/soc/ambiq/Kconfig"
osource "/home/hymbajs/Projects/20_Github/sticker-firmware/sticker-z45/zephyr/soc/allwinner/sun8i_h3/Kconfig"
osource "/home/hymbajs/Projects/20_Github/sticker-firmware/sticker-z45/zephyr/soc/allwinner/sun50i_h618/Kconfig"
osource "/home/hymbajs/Projects/20_Github/sticker-firmware/sticker-z45/zephyr/soc/alif/ensemble/Kconfig"
osource "/home/hymbajs/Projects/20_Github/sticker-firmware/sticker-z45/zephyr/soc/alif/balletto/Kconfig"
osource "/home/hymbajs/Projects/20_Github/sticker-firmware/sticker-z45/zephyr/soc/aesc/Kconfig"
osource "/home/hymbajs/Projects/20_Github/sticker-firmware/sticker-z45/zephyr/soc/adi/max32/Kconfig"
```
