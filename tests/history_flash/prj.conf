## CMakeLists.txt
```
# Copyright (c) 2026 HARDWARIO a.s.
# SPDX-License-Identifier: Apache-2.0

cmake_minimum_required(VERSION 3.20.0)

find_package(Zephyr REQUIRED HINTS $ENV{ZEPHYR_BASE})
project(test_app_history_flash)

set(APP_DIR ${CMAKE_CURRENT_SOURCE_DIR}/../../app)

# Exercises the NVS flash backend of app_history (CONFIG_APP_HISTORY_FLASH=y)
# on the native_sim flash simulator, so the meta-write coalescing and its
# reboot-survival can be validated (the RAM backend in tests/history can't).
target_include_directories(app PRIVATE ${APP_DIR}/src)
target_sources(app PRIVATE
  ${APP_DIR}/src/app_history.c
  ${APP_DIR}/src/app_sensor_types.c
  src/main.c
  src/stubs.c
)
```

## Kconfig
```
# Copyright (c) 2026 HARDWARIO a.s.
# SPDX-License-Identifier: Apache-2.0
#
# Mirror the app's history Kconfig symbols, but select the NVS flash backend
# so the coalescing / reboot-survival path is the one under test.

config APP_HISTORY_FLASH
	bool
	default y

config APP_HISTORY_BYTES
	int
	default 64

source "Kconfig.zephyr"
```

## prj.conf
```kconfig
CONFIG_ZTEST=y
CONFIG_LOG=y
CONFIG_LOG_MODE_MINIMAL=y

# Raw flash ring backend on the native_sim flash simulator (#265).
CONFIG_FLASH=y
CONFIG_FLASH_MAP=y
CONFIG_FLASH_PAGE_LAYOUT=y
CONFIG_FLASH_SIMULATOR=y
CONFIG_CRC=y
```

## app.overlay
```dts
/* Model the STM32WL flash geometry the raw ring backend targets (#265): 2 KB
 * erase pages, 8 B (double word) write unit. A dedicated history partition sits
 * in the 1 MB of flash0 left free above storage_partition (0x100000 ..
 * 0x200000) on native_sim.
 *
 * 4 × 2 KB pages — small enough to exercise page eviction / ring wrap within a
 * few thousand fast in-process captures. */
&flash0 {
	erase-block-size = <2048>;
	write-block-size = <8>;

	partitions {
		history_partition: partition@100000 {
			label = "history";
			reg = <0x00100000 0x00002000>;
		};
	};
};
```

## src/stubs.c
```c
/*
 * Copyright (c) 2026 HARDWARIO a.s.
 * SPDX-License-Identifier: Apache-2.0
 *
 * Clock stub for app_history (APP_HISTORY_HAVE_CLOCK). Tests toggle test_clock_*.
 */

#include "app_radio.h"
#include <stdbool.h>
#include <stdint.h>

bool test_clock_has;
uint32_t test_clock_unix;

int app_clock_get_unix(uint32_t *unix_s)
{
	if (!test_clock_has) {
		return -1;
	}
	*unix_s = test_clock_unix;
	return 0;
}

/* app_radio's flash/exchange gate: nothing is on air here. */
void app_radio_flash_hold(void)
{
}

void app_radio_flash_release(void)
{
}

/* Event log: no flash taken from history in this test. */
uint16_t app_eventlog_flash_pages(void)
{
	return 0;
}
```
