## CMakeLists.txt
```
# Copyright (c) 2026 HARDWARIO a.s.
# SPDX-License-Identifier: Apache-2.0

cmake_minimum_required(VERSION 3.20.0)

# NOTE: do not call this variable APP_DIR — find_package(Zephyr) below
# overwrites APP_DIR with APPLICATION_SOURCE_DIR internally (cmake/modules/
# kconfig.cmake's zephyr_get(APP_DIR ...)), silently clobbering it.
set(APP_SRC_DIR ${CMAKE_CURRENT_SOURCE_DIR}/../../app)

# app_compose.c's W1-slot encoding is CONFIG_W1/CONFIG_DS28E17-gated (issue
# #395), which live in app/Kconfig — reuse it outright instead of duplicating
# the symbols here (same idiom as tests/nfc_hw).
set(KCONFIG_ROOT ${APP_SRC_DIR}/Kconfig)

find_package(Zephyr REQUIRED HINTS $ENV{ZEPHYR_BASE})
project(test_app_compose)

set(APP_DIR ${APP_SRC_DIR})

# Generate app_config.pb.{c,h} like the app does, but with RELPATH = app dir so
# the header lands at <bindir>/src/app_config.pb.h (matching the
# `#include "src/app_config.pb.h"` in app sources).
list(APPEND CMAKE_MODULE_PATH $ENV{ZEPHYR_BASE}/modules/nanopb)
include(nanopb)
set(NANOPB_GENERATE_CPP_STANDALONE OFF)
nanopb_generate_cpp(proto_srcs proto_hdrs RELPATH ${APP_DIR}
  ${APP_DIR}/src/app_config.proto)

target_include_directories(app PRIVATE ${CMAKE_CURRENT_BINARY_DIR} ${APP_DIR}/src)
target_sources(app PRIVATE
  ${proto_srcs}
  ${APP_DIR}/src/app_compose.c
  ${APP_DIR}/src/app_sensor_types.c
  src/main.c
  src/stubs.c
)
```

## prj.conf
```kconfig
CONFIG_ZTEST=y
CONFIG_NANOPB=y
CONFIG_LOG=y
CONFIG_LOG_MODE_MINIMAL=y
CONFIG_TEST_RANDOM_GENERATOR=y

# app_compose.c's W1-slot encoding is now CONFIG_W1/CONFIG_DS28E17-gated
# (issue #395); this suite exercises that path against stubs.c, not a real
# driver, so just needs the Kconfig symbols defined.
CONFIG_W1=y
CONFIG_DS28E17=y
```

## src/stubs.c
```c
/*
 * Copyright (c) 2026 HARDWARIO a.s.
 * SPDX-License-Identifier: Apache-2.0
 *
 * Stubs for app_compose's app-level dependencies. Tests set the test_* state.
 */

#include "app_hall.h"
#include "app_input.h"
#include "app_radio.h"
#include "app_sensor.h"
#include "app_w1_slots.h"

#include "src/app_config.pb.h"

#include <math.h>
#include <stdint.h>

uint8_t test_budget = 200;
struct app_hall_data test_hall;
struct app_input_data test_input;

/* Per-slot expected type the composer reads to decide which slots emit a
 * SensorReading (0 = APP_W1_SLOT_EMPTY = no reading), and the slot state that
 * decides whether values are encoded (default 0 = treated as OK). Tests set
 * these. */
enum app_w1_slot_type test_w1_types[APP_W1_SLOT_COUNT];
enum app_w1_slot_state test_w1_states[APP_W1_SLOT_COUNT];

uint8_t app_w1_slot_get_expected_type(int slot)
{
	if (slot < 0 || slot >= APP_W1_SLOT_COUNT) {
		return APP_W1_SLOT_EMPTY;
	}
	return (uint8_t)test_w1_types[slot];
}

enum app_w1_slot_state app_w1_slot_get_state(int slot)
{
	if (slot < 0 || slot >= APP_W1_SLOT_COUNT) {
		return APP_W1_SLOT_STATE_NONE;
	}
	return test_w1_states[slot] != APP_W1_SLOT_STATE_NONE ? test_w1_states[slot]
							      : APP_W1_SLOT_STATE_OK;
}

enum app_radio_kind test_radio_kind = APP_RADIO_LORAWAN;

enum app_radio_kind app_radio_get_kind(void)
{
	return test_radio_kind;
}

uint8_t app_radio_get_max_payload(void)
{
	return test_budget;
}

/* device_status alarm byte the composer mirrors into system_flags bits 1..8. */
uint32_t test_alarm_flags;

uint32_t app_alarm_status_flags(void)
{
	return test_alarm_flags;
}

int app_hall_get_data(struct app_hall_data *data)
{
	*data = test_hall;
	return 0;
}

int app_input_get_data(struct app_input_data *data)
{
	*data = test_input;
	return 0;
}
```
