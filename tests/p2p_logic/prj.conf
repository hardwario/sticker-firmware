## CMakeLists.txt
```
# Copyright (c) 2026 HARDWARIO a.s.
# SPDX-License-Identifier: Apache-2.0

cmake_minimum_required(VERSION 3.20.0)

# Test-local DT binding for the fake LoRa modem (dts/bindings/lora/...), and
# the app's Kconfig root so CONFIG_APP_CCM_HW_AES resolves (off here -> soft-SE).
list(APPEND DTS_ROOT ${CMAKE_CURRENT_SOURCE_DIR})

# NOTE: not APP_DIR -- find_package(Zephyr) overwrites APP_DIR internally.
set(APP_SRC_DIR ${CMAKE_CURRENT_SOURCE_DIR}/../../app)
set(KCONFIG_ROOT ${APP_SRC_DIR}/Kconfig)

find_package(Zephyr REQUIRED HINTS $ENV{ZEPHYR_BASE})
project(test_app_p2p_logic)

# The module's own path, not one derived from ZEPHYR_BASE: a build may point
# ZEPHYR_MODULES at a loramac-node checkout outside the west workspace.
set(SOFT_SE_DIR ${ZEPHYR_LORAMAC_NODE_MODULE_DIR}/src/peripherals/soft-se)

target_include_directories(app PRIVATE ${APP_SRC_DIR}/src ${SOFT_SE_DIR})

# The TOWER join KAT (tests/ccm/tower_join_kat.json) has fw_version 1.5.0 among
# its inputs, and the JoinRequest tag covers it. This suite compiles
# app_radio_p2p.c directly rather than through app/CMakeLists.txt, so it does not
# inherit the firmware's version definitions and app_version.h would fall back
# to 0.0.0. Pin the fixture's values here: they are inputs to a fixed vector,
# not a claim about what the firmware version is.
target_compile_definitions(app PRIVATE
  APP_VERSION_MAJOR=1
  APP_VERSION_MINOR=5
  APP_VERSION_PATCH=0
)
target_sources(app PRIVATE
  ${APP_SRC_DIR}/src/app_radio_p2p.c
  ${APP_SRC_DIR}/src/app_ccm.c
  ${SOFT_SE_DIR}/aes.c
  src/emul_lora.c
  src/stubs.c
  src/main.c
)
set_source_files_properties(${APP_SRC_DIR}/src/app_ccm.c ${SOFT_SE_DIR}/aes.c
  PROPERTIES COMPILE_DEFINITIONS "AES_ENC_PREKEYED")
```

## prj.conf
```kconfig
CONFIG_ZTEST=y

# app_radio_p2p.c is compiled directly (see CMakeLists); it needs a settings backend
# to link, and a RNG for its retry jitter. A RAM stub store (src/stubs.c) accepts
# every save, or fails them with test_settings_save_ret: the dev_nonce write is
# fail-closed, so a backend whose saves always fail would stop every join.
CONFIG_SETTINGS=y
CONFIG_SETTINGS_CUSTOM=y
CONFIG_TEST_RANDOM_GENERATOR=y

# app_radio_p2p.c's CONFIG_SHELL / CONFIG_WATCHDOG paths are left out to shrink the
# link surface (same technique as tests/alarm_eval): the debug shell helpers
# and the watchdog heartbeat are not part of the pure logic under test.

# The fsk packet CRC16 (p2p_fsk_wrap(), #490).
CONFIG_CRC=y
```

## app.overlay
```dts
/*
 * Copyright (c) 2026 HARDWARIO a.s.
 * SPDX-License-Identifier: Apache-2.0
 */

/ {
	lora_emul: lora-emul {
		compatible = "hardwario,lora-emul";
		status = "okay";
	};

	aliases {
		lora0 = &lora_emul;
	};
};
```

## dts/bindings/lora/hardwario,lora-emul.yaml
```yaml
# Copyright (c) 2026 HARDWARIO a.s.
# SPDX-License-Identifier: Apache-2.0
#
# Minimal fake LoRa modem node so app_radio_p2p.c's DEVICE_DT_GET(DT_ALIAS(lora0))
# resolves on native_sim. The driver (src/emul_lora.c) is a no-op stub -- the
# tests exercise app_radio_p2p.c's pure logic, never the radio.
description: HARDWARIO fake LoRa modem for host tests
compatible: "hardwario,lora-emul"
include: base.yaml
```

## src/emul_lora.c
```c
/*
 * Copyright (c) 2026 HARDWARIO a.s.
 * SPDX-License-Identifier: Apache-2.0
 *
 * Fake LoRa driver so app_radio_p2p.c links and DEVICE_DT_GET(DT_ALIAS(lora0))
 * resolves on native_sim. It records every frame sent, and a test-installed
 * responder -- the suite's gateway -- can answer one: the frames it pushes are
 * handed to the next receiver armed, lora_recv() (the JoinAccept window) or
 * lora_recv_async() (the TOWER ACK and downlink windows), at once or
 * test_lora_rx_delay_ms after the receiver was armed.
 */

#define DT_DRV_COMPAT hardwario_lora_emul

#include "emul_lora.h"

#include <zephyr/device.h>
#include <zephyr/drivers/lora.h>
#include <zephyr/kernel.h>

#include <string.h>

/* What emul_send() returns. 0 (a sent frame) unless a test is exercising a radio
 * fault; the test resets it. */
int test_lora_send_ret;
/* The last frame handed to the radio and the number of sends. */
uint8_t test_lora_last_frame[255];
uint32_t test_lora_last_len;
uint32_t test_lora_send_count;
/* Every sent frame, test_lora_sent[n % TEST_LORA_SENT_MAX] for send n. */
struct test_lora_frame test_lora_sent[TEST_LORA_SENT_MAX];
/* Called with every frame sent; may push the answer with test_lora_rx_push(). */
test_lora_responder_t test_lora_responder;

/* Queued frames reach an armed receiver this long after it was armed (0 = at
 * once): an answer late for a short window but inside a long one. */
uint32_t test_lora_rx_delay_ms;

#define RX_FIFO_DEPTH 4

static struct test_lora_frame m_rx_fifo[RX_FIFO_DEPTH];
static int16_t m_rx_rssi[RX_FIFO_DEPTH];
static int8_t m_rx_snr[RX_FIFO_DEPTH];
static size_t m_rx_count;

void test_lora_rx_push(const uint8_t *buf, size_t len, int16_t rssi, int8_t snr)
{
	if (m_rx_count >= RX_FIFO_DEPTH || len > sizeof(m_rx_fifo[0].buf)) {
		return;
	}
	memcpy(m_rx_fifo[m_rx_count].buf, buf, len);
	m_rx_fifo[m_rx_count].len = (uint8_t)len;
	m_rx_rssi[m_rx_count] = rssi;
	m_rx_snr[m_rx_count] = snr;
	m_rx_count++;
}

static const struct device *m_rx_dev;
static lora_recv_cb m_rx_cb;
static void *m_rx_user;

static void rx_deliver(void)
{
	for (size_t i = 0; i < m_rx_count; i++) {
		m_rx_cb(m_rx_dev, m_rx_fifo[i].buf, m_rx_fifo[i].len, m_rx_rssi[i], m_rx_snr[i],
			m_rx_user);
	}
	m_rx_count = 0;
}

static void rx_delay_expired(struct k_timer *timer)
{
	ARG_UNUSED(timer);
	if (m_rx_cb != NULL) {
		rx_deliver();
	}
}

K_TIMER_DEFINE(m_rx_delay_timer, rx_delay_expired, NULL);

void test_lora_reset(void)
{
	k_timer_stop(&m_rx_delay_timer);
	test_lora_send_ret = 0;
	test_lora_responder = NULL;
	test_lora_rx_delay_ms = 0;
	m_rx_cb = NULL;
	m_rx_count = 0;
}

const struct test_lora_frame *test_lora_sent_frame(uint32_t n)
{
	return &test_lora_sent[n % TEST_LORA_SENT_MAX];
}

static int emul_config(const struct device *dev, struct lora_modem_config *config)
{
	ARG_UNUSED(dev);
	ARG_UNUSED(config);
	return 0;
}

static int emul_send(const struct device *dev, uint8_t *data, uint32_t data_len)
{
	ARG_UNUSED(dev);
	if (test_lora_send_ret != 0) {
		return test_lora_send_ret;
	}

	struct test_lora_frame *f = &test_lora_sent[test_lora_send_count % TEST_LORA_SENT_MAX];

	test_lora_last_len = MIN(data_len, sizeof(test_lora_last_frame));
	memcpy(test_lora_last_frame, data, test_lora_last_len);
	f->len = (uint8_t)test_lora_last_len;
	memcpy(f->buf, data, f->len);
	test_lora_send_count++;
	/* A frame heard before a receiver runs is lost, as on the air. */
	m_rx_count = 0;
	if (test_lora_responder) {
		test_lora_responder(data, data_len);
	}
	return 0;
}

static int emul_send_async(const struct device *dev, uint8_t *data, uint32_t data_len,
			   struct k_poll_signal *async)
{
	ARG_UNUSED(dev);
	ARG_UNUSED(data);
	ARG_UNUSED(data_len);
	ARG_UNUSED(async);
	return -ENOTSUP;
}

static int emul_recv(const struct device *dev, uint8_t *data, uint8_t size, k_timeout_t timeout,
		     int16_t *rssi, int8_t *snr)
{
	ARG_UNUSED(dev);
	ARG_UNUSED(timeout);

	if (m_rx_count == 0) {
		return -ETIMEDOUT;
	}

	uint8_t len = MIN(m_rx_fifo[0].len, size);

	memcpy(data, m_rx_fifo[0].buf, len);
	if (rssi) {
		*rssi = m_rx_rssi[0];
	}
	if (snr) {
		*snr = m_rx_snr[0];
	}
	m_rx_count = 0; /* one frame per window */
	return len;
}

static int emul_recv_async(const struct device *dev, lora_recv_cb cb, void *user_data)
{
	k_timer_stop(&m_rx_delay_timer);
	m_rx_dev = dev;
	m_rx_cb = cb;
	m_rx_user = user_data;
	if (cb == NULL) {
		m_rx_count = 0; /* receiver off: what it did not take is gone */
		return 0;
	}
	if (test_lora_rx_delay_ms > 0) {
		k_timer_start(&m_rx_delay_timer, K_MSEC(test_lora_rx_delay_ms), K_NO_WAIT);
		return 0;
	}
	rx_deliver();
	return 0;
}

static int emul_test_cw(const struct device *dev, uint32_t frequency, int8_t tx_power,
			uint16_t duration)
{
	ARG_UNUSED(dev);
	ARG_UNUSED(frequency);
	ARG_UNUSED(tx_power);
	ARG_UNUSED(duration);
	return -ENOTSUP;
}

static const struct lora_driver_api emul_lora_api = {
	.config = emul_config,
	.send = emul_send,
	.send_async = emul_send_async,
	.recv = emul_recv,
	.recv_async = emul_recv_async,
	.test_cw = emul_test_cw,
};

static int emul_lora_init(const struct device *dev)
{
	ARG_UNUSED(dev);
	return 0;
}

DEVICE_DT_INST_DEFINE(0, emul_lora_init, NULL, NULL, NULL, POST_KERNEL,
		      CONFIG_KERNEL_INIT_PRIORITY_DEVICE, &emul_lora_api);
```

## src/emul_lora.h
```c
/*
 * Copyright (c) 2026 HARDWARIO a.s.
 * SPDX-License-Identifier: Apache-2.0
 *
 * The fake LoRa driver's test surface (src/emul_lora.c).
 */

#ifndef EMUL_LORA_H_
#define EMUL_LORA_H_

#include <stddef.h>
#include <stdint.h>

#define TEST_LORA_SENT_MAX 16

struct test_lora_frame {
	uint8_t buf[255];
	uint8_t len;
};

typedef void (*test_lora_responder_t)(const uint8_t *frame, uint32_t len);

extern int test_lora_send_ret;
extern uint8_t test_lora_last_frame[255];
extern uint32_t test_lora_last_len;
extern uint32_t test_lora_send_count;
extern test_lora_responder_t test_lora_responder;
extern uint32_t test_lora_rx_delay_ms;

/* Queue a frame for the next receiver the module arms. */
void test_lora_rx_push(const uint8_t *buf, size_t len, int16_t rssi, int8_t snr);
/* No responder, no fault, nothing queued. The counters keep running. */
void test_lora_reset(void);
/* Send number `n` (0-based, test_lora_send_count before it went out). */
const struct test_lora_frame *test_lora_sent_frame(uint32_t n);

#endif /* EMUL_LORA_H_ */
```

## src/stubs.c
```c
/*
 * Copyright (c) 2026 HARDWARIO a.s.
 * SPDX-License-Identifier: Apache-2.0
 *
 * Minimal stubs so app_radio_p2p.c links on native_sim: the global config it reads
 * and the app_compose entry points it calls. The pure-logic tests never drive
 * a real send/compose, so these can be trivial. app_ccm.c is the REAL source
 * (linked in CMakeLists) -- the frame codec tests need genuine CCM. The history
 * replay moved to app_radio (doc/plan/460 F3c), tested in tests/radio_common.
 */

#include "app_battery.h"
#include "app_compose.h"
#include "app_config.h"
#include "app_radio.h"

#include <zephyr/init.h>
#include <zephyr/kernel.h>
#include <zephyr/settings/settings.h>
#include <zephyr/toolchain.h>

#include <errno.h>
#include <math.h>
#include <string.h>
#include <stdbool.h>
#include <stddef.h>
#include <stdint.h>
#include <string.h>

struct app_config g_app_config;

/* Counts every telemetry compose the P2P send path attempted. */
int g_compose_budget_calls;
/* Frame length the compose stub reports (0 = nothing to send), and how many
 * times the P2P send path reset the snapshot. */
size_t test_compose_len;
int g_compose_reset_calls;

int app_compose_budget(uint8_t *buf, size_t size, size_t *len, bool *more, uint8_t budget)
{
	ARG_UNUSED(buf);
	ARG_UNUSED(size);
	ARG_UNUSED(budget);
	g_compose_budget_calls++;
	if (len) {
		*len = test_compose_len < size ? test_compose_len : size;
	}
	if (more) {
		*more = false;
	}
	return 0;
}

void app_compose_reset(void)
{
	g_compose_reset_calls++;
}

/* The Hello's reset_reason byte (app_cmd.c is not built here). */
uint32_t test_reset_cause = 0x08; /* RESET_POR */

uint32_t app_cmd_get_reset_cause(void)
{
	return test_reset_cause;
}

/* Last value handed to the network-time setter (0 = none), for the TimeAns
 * tests. */
uint32_t g_test_network_time;

int app_clock_set_network_time(uint32_t unix_time)
{
	g_test_network_time = unix_time;
	return 0;
}

/* Common announce (app_radio.c is not built here): count the calls so tests
 * can check that the backend hands it to app_radio. */
int p2p_test_announce_calls;

void app_radio_announce(void)
{
	p2p_test_announce_calls++;
}

/* The common network-time state (F3d): the backend reads the wanted flag and
 * reports a landed time; tests drive the one and count the other. */
bool p2p_test_time_wanted;
int p2p_test_time_events;

bool app_radio_time_wanted(void)
{
	return p2p_test_time_wanted;
}

void app_radio_time_event(void)
{
	p2p_test_time_events++;
}

/* The radio work queue app_radio.c owns (doc/plan/439 T2a) -- initialised but
 * never started. Every handler under test is driven on the test thread by its
 * hook (p2p_test_join_step(), p2p_test_ctrl_run()), so nothing the module
 * schedules can run underneath the assertions: a submit to a queue that is not
 * started is refused, and a delayed one keeps its timer for
 * p2p_test_join_pending_ms() to read. */
static struct k_work_q m_radio_wq;

struct k_work_q *app_radio_work_q(void)
{
	return &m_radio_wq;
}

static int radio_wq_init(void)
{
	k_work_queue_init(&m_radio_wq);
	return 0;
}

SYS_INIT(radio_wq_init, APPLICATION, CONFIG_APPLICATION_INIT_PRIORITY);

/* RadioState push API (app_radio.c is not built here): record what the backend
 * reports so tests can check it (#446). */
int16_t p2p_test_dl_rssi;
int8_t p2p_test_dl_snr;
int p2p_test_dl_calls;
int p2p_test_link_ups;
int p2p_test_link_ok_calls;
int p2p_test_link_fail_calls;
uint32_t p2p_test_join_attempts;
uint32_t p2p_test_cnt[APP_RADIO_CNT_COUNT];

void app_radio_count(enum app_radio_counter c)
{
	if (c < APP_RADIO_CNT_COUNT) {
		p2p_test_cnt[c]++;
	}
}

void app_radio_note_downlink(int16_t rssi, int8_t snr)
{
	p2p_test_dl_rssi = rssi;
	p2p_test_dl_snr = snr;
	p2p_test_dl_calls++;
}

void app_radio_set_params(uint8_t sf, int datarate, int8_t tx_power_dbm)
{
	ARG_UNUSED(sf);
	ARG_UNUSED(datarate);
	ARG_UNUSED(tx_power_dbm);
}

/* The LinkCheckAns numbers the backend pushes (plan §7.6). */
int16_t p2p_test_ul_rssi;
int8_t p2p_test_ul_snr;
uint8_t p2p_test_ul_margin;
uint8_t p2p_test_ul_gw_count;

void app_radio_set_uplink_rssi(int16_t rssi, int8_t snr)
{
	p2p_test_ul_rssi = rssi;
	p2p_test_ul_snr = snr;
}

void app_radio_set_uplink_margin(uint8_t margin, uint8_t gw_count)
{
	p2p_test_ul_margin = margin;
	p2p_test_ul_gw_count = gw_count;
}

void app_radio_set_session(uint32_t dev_addr, uint32_t fcnt_up)
{
	ARG_UNUSED(dev_addr);
	ARG_UNUSED(fcnt_up);
}

/* Link supervision lives in app_radio (tests/radio_common); the backend only
 * reports what it saw. */
void app_radio_link_up(void)
{
	p2p_test_link_ups++;
}

void app_radio_link_result(bool ok)
{
	if (ok) {
		p2p_test_link_ok_calls++;
	} else {
		p2p_test_link_fail_calls++;
	}
}

void app_radio_note_send(bool sent, bool duty_held)
{
	ARG_UNUSED(sent);
	ARG_UNUSED(duty_held);
}

void app_radio_note_uplink(void)
{
}

void app_radio_heartbeat_start(void)
{
}

void app_radio_heartbeat_feed(void)
{
}

void app_radio_set_join_attempts(uint32_t n)
{
	p2p_test_join_attempts = n;
}

void app_radio_set_duty_held(bool held)
{
	ARG_UNUSED(held);
}

/* The common duty ledger (app_radio.c, T2d), stubbed: a settable hold for the
 * join path, and a record of what the backend charged. */
int64_t test_duty_wait_ms;
uint32_t test_duty_charges;
uint64_t test_duty_charged_ms;
uint32_t test_duty_budget_ms;

void app_radio_duty_init(uint32_t budget_ms)
{
	test_duty_budget_ms = budget_ms;
}

int64_t app_radio_duty_wait_ms(uint32_t air_ms)
{
	ARG_UNUSED(air_ms);
	return test_duty_wait_ms;
}

void app_radio_duty_charge(uint32_t air_ms)
{
	test_duty_charges++;
	test_duty_charged_ms += air_ms;
}

void app_radio_reset_link(void)
{
}

/* The network backoff (app_radio.c, P2P 0x15): what the backend set, and a
 * settable hold for the 0x91 uplink. Its TX hold is tested in tests/radio_common. */
uint32_t test_backoff_s;
int test_backoff_calls;
int64_t test_backoff_wait_ms;

void app_radio_backoff_set(uint32_t s)
{
	test_backoff_s = s;
	test_backoff_calls++;
}

int64_t app_radio_backoff_wait_ms(void)
{
	return test_backoff_wait_ms;
}

/* The DevStatusAns battery (app_battery.c is not built here): volts, NAN = none. */
float test_battery_v = NAN;

float app_battery_last_sample(void)
{
	return test_battery_v;
}

/* Common downlink path (app_radio.c, doc/plan/460 F3): a received command is
 * handed over here; its dispatch is tested in tests/radio_common. The last one
 * is kept for the envelope checks. */
int p2p_test_downlinks;
uint8_t p2p_test_downlink_buf[80];
size_t p2p_test_downlink_len;

void app_radio_downlink(const uint8_t *buf, size_t len)
{
	p2p_test_downlink_len = MIN(len, sizeof(p2p_test_downlink_buf));
	memcpy(p2p_test_downlink_buf, buf, p2p_test_downlink_len);
	p2p_test_downlinks++;
}

/* Common TX core (app_radio.c is not built here, doc/plan/460 F4): record what
 * the backend queues and how often it kicks the scheduler; its queues, retries
 * and report split are tested in tests/radio_common. */
int p2p_test_tx_queue_calls;
int p2p_test_tx_kick_calls;
enum app_radio_frame_kind p2p_test_tx_queue_kind;

int app_radio_tx_queue(enum app_radio_frame_kind kind, enum app_radio_frame_tag tag, uint8_t port,
		       const uint8_t *buf, size_t len)
{
	ARG_UNUSED(tag);
	ARG_UNUSED(port);
	ARG_UNUSED(buf);
	ARG_UNUSED(len);
	p2p_test_tx_queue_calls++;
	p2p_test_tx_queue_kind = kind;
	return 0;
}

void app_radio_tx_kick(void)
{
	p2p_test_tx_kick_calls++;
}

bool p2p_test_ack_pending; /* app_radio holds a confirmed frame for its retry */

bool app_radio_ack_pending(void)
{
	return p2p_test_ack_pending;
}

bool app_radio_tx_answer_pending(void)
{
	return false;
}

uint32_t app_radio_tx_answer_free(void)
{
	return APP_RADIO_TX_QUEUE_DEPTH;
}

size_t app_radio_tx_answer_cap(size_t buf_size)
{
	return MIN(buf_size, (size_t)APP_RADIO_TX_SLOT_SIZE);
}

/* ---- settings: a RAM stub store (CONFIG_SETTINGS_CUSTOM). Saves succeed unless
 * a case sets test_settings_save_ret; only the last p2pjoin/state record is
 * kept, for a case to load back. ---- */

int test_settings_save_ret;
uint8_t test_join_state[32];
size_t test_join_state_len;

static int stub_store_load(struct settings_store *cs, const struct settings_load_arg *arg)
{
	ARG_UNUSED(cs);
	ARG_UNUSED(arg);
	return 0;
}

static int stub_store_save(struct settings_store *cs, const char *name, const char *value,
			   size_t val_len)
{
	ARG_UNUSED(cs);
	if (!test_settings_save_ret && strcmp(name, "p2pjoin/state") == 0 &&
	    val_len <= sizeof(test_join_state)) {
		memcpy(test_join_state, value, val_len);
		test_join_state_len = val_len;
	}
	return test_settings_save_ret;
}

static const struct settings_store_itf stub_store_itf = {
	.csi_load = stub_store_load,
	.csi_save = stub_store_save,
};

static struct settings_store stub_store = {.cs_itf = &stub_store_itf};

int settings_backend_init(void)
{
	settings_dst_register(&stub_store);
	settings_src_register(&stub_store);
	return 0;
}

/* Nothing in this suite runs main(): bring the settings subsystem up here so
 * the stub store is the save destination. */
static int stub_settings_init(void)
{
	return settings_subsys_init();
}

SYS_INIT(stub_settings_init, APPLICATION, 0);

/* app_radio's flash/exchange gate: counted, so a test can check that every
 * exchange a TX began is ended again. */
int p2p_test_air_begins;
int p2p_test_air_ends;

void app_radio_air_begin(void)
{
	p2p_test_air_begins++;
}

void app_radio_air_end(void)
{
	p2p_test_air_ends++;
}
```

## src/tower_ack_ctrl_kat.h
```c
/* Generated from tests/ccm/p2p_tower_ack_ctrl_kat.txt, sha256
 * 6b8d66d9bacabd9e1aefae375fe20fdcaf536c781b3aa74497790dbb36b82966 --
 * the TOWER ACK CTRL-tail KAT (plan #470 §13.5) of the Northbridge
 * (fiber-northbridge tests/tower_gateway/gen_ack_ctrl_kat.py), shared verbatim.
 * Do not edit by hand. */

#ifndef TOWER_ACK_CTRL_KAT_H_
#define TOWER_ACK_CTRL_KAT_H_

#include <stdbool.h>
#include <stddef.h>
#include <stdint.h>

/* One line of the KAT. `ack` lines carry the node's uplink (up_*) and the
 * gateway's ACK to it; `tail` lines a hand-built ACK and the TLV ids its tail
 * holds, in order (tlvs). */
struct tower_ack_ctrl_kat {
	const char *name;
	bool tail_line;
	uint32_t up_ctr;
	const uint8_t *up_pt;
	size_t up_pt_len;
	const uint8_t *up_frame;
	size_t up_frame_len;
	bool anchor; /* the gateway had a time anchor */
	bool pending;
	uint32_t ack_ctr;
	const uint8_t *ack_pt;
	size_t ack_pt_len;
	const uint8_t *ack_frame;
	size_t ack_frame_len;
	const uint8_t *tlvs;
	size_t tlv_count;
};

static const uint8_t ack_ctrl_kat_lc_only_ack_pt[] = {
	0x02, 0x00, 0x00, 0x00, 0xc7, 0x02, 0x10, 0x04, 0xc7, 0x05, 0x0c, 0x01,
};
static const uint8_t ack_ctrl_kat_lc_only_ack_frame[] = {
	0x21, 0x00, 0x01, 0x00, 0x42, 0x4e, 0x13, 0x04, 0x00, 0x00, 0x64, 0x00,
	0x00, 0x00, 0x85, 0x1b, 0x40, 0x13, 0x39, 0x65, 0x74, 0x3e, 0xe2, 0x73,
	0x10, 0x8e, 0x85, 0xd0, 0x8c, 0x41, 0x26, 0xb3, 0xe4, 0xaf,
};
static const uint8_t ack_ctrl_kat_lc_only_up_pt[] = {
	0x91, 0x10, 0x00,
};
static const uint8_t ack_ctrl_kat_lc_only_up_frame[] = {
	0x20, 0x01, 0x13, 0x04, 0x00, 0x00, 0x01, 0x00, 0x42, 0x4e, 0x02, 0x00,
	0x00, 0x00, 0xc2, 0x01, 0x2a, 0x29, 0x18, 0xe9, 0xfd, 0x5c, 0x98, 0x9d,
	0x0a,
};

static const uint8_t ack_ctrl_kat_time_only_ack_pt[] = {
	0x03, 0x00, 0x00, 0x00, 0xc7, 0x02, 0x20, 0x09, 0x80, 0x3b, 0xb1, 0x6a,
	0x80, 0x03, 0x00, 0x00, 0x00,
};
static const uint8_t ack_ctrl_kat_time_only_ack_frame[] = {
	0x21, 0x00, 0x01, 0x00, 0x42, 0x4e, 0x13, 0x04, 0x00, 0x00, 0x65, 0x00,
	0x00, 0x00, 0xd6, 0x7e, 0x8b, 0x70, 0xa5, 0xc2, 0xa0, 0xc3, 0xee, 0x01,
	0x5b, 0xd8, 0x19, 0x64, 0x3f, 0x98, 0xbb, 0x44, 0x9b, 0x20, 0x8e, 0xee,
	0x03, 0x30, 0x2c,
};
static const uint8_t ack_ctrl_kat_time_only_up_pt[] = {
	0x91, 0x20, 0x00,
};
static const uint8_t ack_ctrl_kat_time_only_up_frame[] = {
	0x20, 0x01, 0x13, 0x04, 0x00, 0x00, 0x01, 0x00, 0x42, 0x4e, 0x03, 0x00,
	0x00, 0x00, 0x8b, 0x2d, 0x6a, 0xb0, 0xc6, 0x61, 0x43, 0x59, 0xb3, 0x60,
	0x6f,
};

static const uint8_t ack_ctrl_kat_lc_time_ack_pt[] = {
	0x04, 0x00, 0x00, 0x00, 0xa8, 0x02, 0x10, 0x04, 0xa8, 0xf8, 0x00, 0x01,
	0x20, 0x09, 0xbc, 0x3b, 0xb1, 0x6a, 0xff, 0x04, 0x00, 0x00, 0x00,
};
static const uint8_t ack_ctrl_kat_lc_time_ack_frame[] = {
	0x21, 0x00, 0x01, 0x00, 0x42, 0x4e, 0x13, 0x04, 0x00, 0x00, 0x66, 0x00,
	0x00, 0x00, 0x6a, 0x4c, 0x41, 0x87, 0xf6, 0xb3, 0x9c, 0x9d, 0xfd, 0xa6,
	0x04, 0x90, 0x1d, 0xfc, 0x1a, 0xc8, 0x79, 0x5e, 0xdc, 0x2d, 0x43, 0xb8,
	0x6f, 0xeb, 0x79, 0xd8, 0xd9, 0x41, 0x27, 0x4a, 0x6b,
};
static const uint8_t ack_ctrl_kat_lc_time_up_pt[] = {
	0x91, 0x20, 0x00, 0x10, 0x00,
};
static const uint8_t ack_ctrl_kat_lc_time_up_frame[] = {
	0x20, 0x01, 0x13, 0x04, 0x00, 0x00, 0x01, 0x00, 0x42, 0x4e, 0x04, 0x00,
	0x00, 0x00, 0xa9, 0x7f, 0x3d, 0xb1, 0x08, 0x68, 0x33, 0x28, 0xc5, 0xfb,
	0x6b, 0x13, 0x4e,
};

static const uint8_t ack_ctrl_kat_lc_time_pending_ack_pt[] = {
	0x05, 0x00, 0x00, 0x00, 0x9b, 0x03, 0x10, 0x04, 0x9b, 0xf5, 0xfd, 0x01,
	0x20, 0x09, 0x81, 0x3b, 0xb1, 0x6a, 0x01, 0x05, 0x00, 0x00, 0x00,
};
static const uint8_t ack_ctrl_kat_lc_time_pending_ack_frame[] = {
	0x21, 0x00, 0x01, 0x00, 0x42, 0x4e, 0x13, 0x04, 0x00, 0x00, 0x67, 0x00,
	0x00, 0x00, 0x35, 0xd6, 0xd9, 0x26, 0xa9, 0xf3, 0x57, 0x2f, 0xbe, 0x96,
	0xa0, 0x3e, 0xf7, 0x78, 0xff, 0x00, 0x54, 0xdb, 0xc6, 0xe8, 0x31, 0x7c,
	0x20, 0x2e, 0x58, 0xff, 0xa2, 0x02, 0xbe, 0x67, 0x94,
};
static const uint8_t ack_ctrl_kat_lc_time_pending_up_pt[] = {
	0x91, 0x10, 0x00, 0x20, 0x00,
};
static const uint8_t ack_ctrl_kat_lc_time_pending_up_frame[] = {
	0x20, 0x01, 0x13, 0x04, 0x00, 0x00, 0x01, 0x00, 0x42, 0x4e, 0x05, 0x00,
	0x00, 0x00, 0x00, 0x2c, 0xa6, 0xee, 0x22, 0x9f, 0x3f, 0xc6, 0xc0, 0x28,
	0xcc, 0x28, 0x4a,
};

static const uint8_t ack_ctrl_kat_lc_time_pending_rep_ack_pt[] = {
	0x05, 0x00, 0x00, 0x00, 0x9d, 0x03, 0x10, 0x04, 0x9d, 0xf6, 0xfe, 0x01,
	0x20, 0x09, 0x81, 0x3b, 0xb1, 0x6a, 0x57, 0x05, 0x00, 0x00, 0x00,
};
static const uint8_t ack_ctrl_kat_lc_time_pending_rep_ack_frame[] = {
	0x21, 0x00, 0x01, 0x00, 0x42, 0x4e, 0x13, 0x04, 0x00, 0x00, 0x68, 0x00,
	0x00, 0x00, 0xd8, 0x08, 0xc2, 0xea, 0x00, 0xee, 0xea, 0x4b, 0x0c, 0x54,
	0x0a, 0x9c, 0x5e, 0xd7, 0x12, 0xf5, 0xb9, 0x8b, 0xcf, 0xec, 0x6e, 0x57,
	0x89, 0xb5, 0xc1, 0x25, 0x03, 0xfb, 0x10, 0x84, 0xca,
};
static const uint8_t ack_ctrl_kat_lc_time_pending_rep_up_pt[] = {
	0x91, 0x10, 0x00, 0x20, 0x00,
};
static const uint8_t ack_ctrl_kat_lc_time_pending_rep_up_frame[] = {
	0x20, 0x01, 0x13, 0x04, 0x00, 0x00, 0x01, 0x00, 0x42, 0x4e, 0x05, 0x00,
	0x00, 0x00, 0x00, 0x2c, 0xa6, 0xee, 0x22, 0x9f, 0x3f, 0xc6, 0xc0, 0x28,
	0xcc, 0x28, 0x4a,
};

static const uint8_t ack_ctrl_kat_lc_with_others_ack_pt[] = {
	0x06, 0x00, 0x00, 0x00, 0xba, 0x02, 0x10, 0x04, 0xba, 0x00, 0x07, 0x01,
};
static const uint8_t ack_ctrl_kat_lc_with_others_ack_frame[] = {
	0x21, 0x00, 0x01, 0x00, 0x42, 0x4e, 0x13, 0x04, 0x00, 0x00, 0x69, 0x00,
	0x00, 0x00, 0xeb, 0x4a, 0x2a, 0x96, 0x3c, 0x25, 0xb6, 0x2c, 0x3c, 0x44,
	0xcd, 0xd2, 0x4d, 0xc6, 0x9a, 0x64, 0x86, 0x99, 0xe8, 0xb0,
};
static const uint8_t ack_ctrl_kat_lc_with_others_up_pt[] = {
	0x91, 0x01, 0x0c, 0x00, 0x00, 0x00, 0x00, 0x00, 0x00, 0x00, 0x00, 0x00,
	0x00, 0x00, 0x00, 0x10, 0x00, 0x02, 0x09, 0x00, 0x00, 0x00, 0x00, 0x00,
	0x00, 0x00, 0x00, 0x00,
};
static const uint8_t ack_ctrl_kat_lc_with_others_up_frame[] = {
	0x20, 0x01, 0x13, 0x04, 0x00, 0x00, 0x01, 0x00, 0x42, 0x4e, 0x06, 0x00,
	0x00, 0x00, 0xd4, 0x42, 0x13, 0x82, 0xd3, 0x99, 0x18, 0x01, 0xa1, 0xc1,
	0x37, 0x84, 0xb0, 0xd6, 0x6a, 0xb2, 0x5c, 0x7d, 0xd4, 0x3a, 0xe7, 0xd0,
	0x78, 0xfa, 0xa6, 0xd6, 0x64, 0x68, 0xce, 0x2a, 0x3b, 0x03, 0xc9, 0x2c,
	0x59, 0xf1,
};

static const uint8_t ack_ctrl_kat_lc_sf12_margin_zero_ack_pt[] = {
	0x07, 0x00, 0x00, 0x00, 0x80, 0x02, 0x10, 0x04, 0x80, 0xec, 0x00, 0x01,
};
static const uint8_t ack_ctrl_kat_lc_sf12_margin_zero_ack_frame[] = {
	0x21, 0x00, 0x01, 0x00, 0x42, 0x4e, 0x13, 0x04, 0x00, 0x00, 0x6a, 0x00,
	0x00, 0x00, 0x11, 0x62, 0x0c, 0xc3, 0x78, 0x0a, 0x7b, 0xf2, 0x72, 0xb6,
	0xff, 0x37, 0xae, 0x77, 0x00, 0xcc, 0x7e, 0x00, 0x5d, 0x78,
};
static const uint8_t ack_ctrl_kat_lc_sf12_margin_zero_up_pt[] = {
	0x91, 0x10, 0x00,
};
static const uint8_t ack_ctrl_kat_lc_sf12_margin_zero_up_frame[] = {
	0x20, 0x01, 0x13, 0x04, 0x00, 0x00, 0x01, 0x00, 0x42, 0x4e, 0x07, 0x00,
	0x00, 0x00, 0x44, 0x55, 0x65, 0x2d, 0x18, 0xff, 0x8c, 0xd7, 0x85, 0x6a,
	0x2f,
};

static const uint8_t ack_ctrl_kat_lc_sf12_margin_neg_ack_pt[] = {
	0x08, 0x00, 0x00, 0x00, 0x80, 0x02, 0x10, 0x04, 0x80, 0xeb, 0xff, 0x01,
};
static const uint8_t ack_ctrl_kat_lc_sf12_margin_neg_ack_frame[] = {
	0x21, 0x00, 0x01, 0x00, 0x42, 0x4e, 0x13, 0x04, 0x00, 0x00, 0x6b, 0x00,
	0x00, 0x00, 0xe2, 0x68, 0x2e, 0xbd, 0x03, 0x19, 0xc3, 0x35, 0x01, 0xba,
	0xe2, 0x63, 0x74, 0xc7, 0xc1, 0xdc, 0x3f, 0xe9, 0xae, 0x85,
};
static const uint8_t ack_ctrl_kat_lc_sf12_margin_neg_up_pt[] = {
	0x91, 0x10, 0x00,
};
static const uint8_t ack_ctrl_kat_lc_sf12_margin_neg_up_frame[] = {
	0x20, 0x01, 0x13, 0x04, 0x00, 0x00, 0x01, 0x00, 0x42, 0x4e, 0x08, 0x00,
	0x00, 0x00, 0x01, 0xc7, 0x99, 0x1c, 0x74, 0x6a, 0x79, 0xa1, 0x00, 0xbe,
	0x19,
};

static const uint8_t ack_ctrl_kat_lc_clamp_ack_pt[] = {
	0x09, 0x00, 0x00, 0x00, 0x80, 0x02, 0x10, 0x04, 0x80, 0x1f, 0x2e, 0x01,
};
static const uint8_t ack_ctrl_kat_lc_clamp_ack_frame[] = {
	0x21, 0x00, 0x01, 0x00, 0x42, 0x4e, 0x13, 0x04, 0x00, 0x00, 0x6c, 0x00,
	0x00, 0x00, 0xf2, 0x14, 0x1b, 0xc9, 0x4f, 0x5e, 0x6c, 0x01, 0x8c, 0x2a,
	0x76, 0x08, 0xbe, 0xcd, 0x37, 0x80, 0x67, 0x54, 0xd1, 0x10,
};
static const uint8_t ack_ctrl_kat_lc_clamp_up_pt[] = {
	0x91, 0x10, 0x00,
};
static const uint8_t ack_ctrl_kat_lc_clamp_up_frame[] = {
	0x20, 0x01, 0x13, 0x04, 0x00, 0x00, 0x01, 0x00, 0x42, 0x4e, 0x09, 0x00,
	0x00, 0x00, 0x1d, 0x40, 0xd9, 0x23, 0xb8, 0xc5, 0x93, 0x3c, 0x8b, 0x2d,
	0xba,
};

static const uint8_t ack_ctrl_kat_time_frac_255_ack_pt[] = {
	0x0a, 0x00, 0x00, 0x00, 0xc4, 0x02, 0x20, 0x09, 0x80, 0x3b, 0xb1, 0x6a,
	0xff, 0x0a, 0x00, 0x00, 0x00,
};
static const uint8_t ack_ctrl_kat_time_frac_255_ack_frame[] = {
	0x21, 0x00, 0x01, 0x00, 0x42, 0x4e, 0x13, 0x04, 0x00, 0x00, 0x6d, 0x00,
	0x00, 0x00, 0xa6, 0xd6, 0x67, 0x37, 0x32, 0x76, 0x4a, 0x91, 0x17, 0xed,
	0x0d, 0xaf, 0xea, 0x67, 0x88, 0xf6, 0xf0, 0xdf, 0x33, 0xd1, 0x1d, 0xf5,
	0x40, 0x44, 0xd5,
};
static const uint8_t ack_ctrl_kat_time_frac_255_up_pt[] = {
	0x91, 0x20, 0x00,
};
static const uint8_t ack_ctrl_kat_time_frac_255_up_frame[] = {
	0x20, 0x01, 0x13, 0x04, 0x00, 0x00, 0x01, 0x00, 0x42, 0x4e, 0x0a, 0x00,
	0x00, 0x00, 0x3d, 0x53, 0xa6, 0x09, 0x74, 0x84, 0x37, 0xa3, 0xc8, 0x04,
	0x43,
};

static const uint8_t ack_ctrl_kat_time_frac_1_ack_pt[] = {
	0x0b, 0x00, 0x00, 0x00, 0xc4, 0x02, 0x20, 0x09, 0x80, 0x3b, 0xb1, 0x6a,
	0x01, 0x0b, 0x00, 0x00, 0x00,
};
static const uint8_t ack_ctrl_kat_time_frac_1_ack_frame[] = {
	0x21, 0x00, 0x01, 0x00, 0x42, 0x4e, 0x13, 0x04, 0x00, 0x00, 0x6e, 0x00,
	0x00, 0x00, 0x0a, 0x18, 0x6e, 0x39, 0xe3, 0xa5, 0x77, 0x00, 0x2c, 0x88,
	0xbc, 0x3a, 0x01, 0xe1, 0x70, 0x00, 0x3b, 0x3e, 0x44, 0x51, 0xae, 0x34,
	0x0a, 0xb4, 0xd5,
};
static const uint8_t ack_ctrl_kat_time_frac_1_up_pt[] = {
	0x91, 0x20, 0x00,
};
static const uint8_t ack_ctrl_kat_time_frac_1_up_frame[] = {
	0x20, 0x01, 0x13, 0x04, 0x00, 0x00, 0x01, 0x00, 0x42, 0x4e, 0x0b, 0x00,
	0x00, 0x00, 0x64, 0x28, 0x69, 0xe7, 0xc3, 0x2c, 0x5b, 0x86, 0xc8, 0xd7,
	0x9b,
};

static const uint8_t ack_ctrl_kat_time_frac_0_ack_pt[] = {
	0x0c, 0x00, 0x00, 0x00, 0xc4, 0x02, 0x20, 0x09, 0x80, 0x3b, 0xb1, 0x6a,
	0x00, 0x0c, 0x00, 0x00, 0x00,
};
static const uint8_t ack_ctrl_kat_time_frac_0_ack_frame[] = {
	0x21, 0x00, 0x01, 0x00, 0x42, 0x4e, 0x13, 0x04, 0x00, 0x00, 0x6f, 0x00,
	0x00, 0x00, 0x15, 0x48, 0x2f, 0x72, 0x53, 0x17, 0xfd, 0x95, 0x79, 0xda,
	0xac, 0x6c, 0xab, 0xc1, 0xcc, 0xd8, 0x46, 0xad, 0xd7, 0xab, 0x9f, 0xea,
	0xfd, 0x04, 0x2d,
};
static const uint8_t ack_ctrl_kat_time_frac_0_up_pt[] = {
	0x91, 0x20, 0x00,
};
static const uint8_t ack_ctrl_kat_time_frac_0_up_frame[] = {
	0x20, 0x01, 0x13, 0x04, 0x00, 0x00, 0x01, 0x00, 0x42, 0x4e, 0x0c, 0x00,
	0x00, 0x00, 0x6b, 0x47, 0x10, 0x7f, 0x80, 0x05, 0xd3, 0xa8, 0x67, 0xe4,
	0x06,
};

static const uint8_t ack_ctrl_kat_time_before_anchor_ack_pt[] = {
	0x0d, 0x00, 0x00, 0x00, 0xc4, 0x02, 0x20, 0x09, 0x7f, 0x3b, 0xb1, 0x6a,
	0x40, 0x0d, 0x00, 0x00, 0x00,
};
static const uint8_t ack_ctrl_kat_time_before_anchor_ack_frame[] = {
	0x21, 0x00, 0x01, 0x00, 0x42, 0x4e, 0x13, 0x04, 0x00, 0x00, 0x70, 0x00,
	0x00, 0x00, 0xe8, 0xd2, 0x44, 0xcc, 0x67, 0xaf, 0xf7, 0xea, 0xf2, 0xda,
	0x78, 0x26, 0x14, 0xec, 0x5c, 0x63, 0xbb, 0xd2, 0xcf, 0x90, 0x90, 0xfa,
	0xea, 0x8f, 0x3d,
};
static const uint8_t ack_ctrl_kat_time_before_anchor_up_pt[] = {
	0x91, 0x20, 0x00,
};
static const uint8_t ack_ctrl_kat_time_before_anchor_up_frame[] = {
	0x20, 0x01, 0x13, 0x04, 0x00, 0x00, 0x01, 0x00, 0x42, 0x4e, 0x0d, 0x00,
	0x00, 0x00, 0xc8, 0xe2, 0xcd, 0xba, 0x85, 0x85, 0x2c, 0x25, 0x86, 0x0c,
	0xcf,
};

static const uint8_t ack_ctrl_kat_time_no_anchor_ack_pt[] = {
	0x0e, 0x00, 0x00, 0x00, 0xc4, 0x00,
};
static const uint8_t ack_ctrl_kat_time_no_anchor_ack_frame[] = {
	0x21, 0x00, 0x01, 0x00, 0x42, 0x4e, 0x13, 0x04, 0x00, 0x00, 0x71, 0x00,
	0x00, 0x00, 0x4e, 0x9a, 0x09, 0x2d, 0xd8, 0x93, 0xb0, 0x8d, 0x59, 0x20,
	0x4e, 0xa9, 0x7a, 0x0d,
};
static const uint8_t ack_ctrl_kat_time_no_anchor_up_pt[] = {
	0x91, 0x20, 0x00,
};
static const uint8_t ack_ctrl_kat_time_no_anchor_up_frame[] = {
	0x20, 0x01, 0x13, 0x04, 0x00, 0x00, 0x01, 0x00, 0x42, 0x4e, 0x0e, 0x00,
	0x00, 0x00, 0xa4, 0x5d, 0x47, 0x8b, 0x4a, 0x85, 0x42, 0x46, 0x9e, 0x82,
	0xa8,
};

static const uint8_t ack_ctrl_kat_lc_time_no_anchor_ack_pt[] = {
	0x0f, 0x00, 0x00, 0x00, 0xc4, 0x03, 0x10, 0x04, 0xc4, 0x02, 0x09, 0x01,
};
static const uint8_t ack_ctrl_kat_lc_time_no_anchor_ack_frame[] = {
	0x21, 0x00, 0x01, 0x00, 0x42, 0x4e, 0x13, 0x04, 0x00, 0x00, 0x72, 0x00,
	0x00, 0x00, 0x05, 0xc0, 0x2a, 0xd7, 0xd4, 0x25, 0x44, 0xcf, 0x5a, 0xff,
	0xe2, 0x77, 0xcf, 0x88, 0xe7, 0x33, 0x7d, 0x18, 0x40, 0xa9,
};
static const uint8_t ack_ctrl_kat_lc_time_no_anchor_up_pt[] = {
	0x91, 0x10, 0x00, 0x20, 0x00,
};
static const uint8_t ack_ctrl_kat_lc_time_no_anchor_up_frame[] = {
	0x20, 0x01, 0x13, 0x04, 0x00, 0x00, 0x01, 0x00, 0x42, 0x4e, 0x0f, 0x00,
	0x00, 0x00, 0xc4, 0x4e, 0x0f, 0xfe, 0x7b, 0xf1, 0x2d, 0xde, 0x37, 0xdb,
	0x7d, 0x04, 0x05,
};

static const uint8_t ack_ctrl_kat_data_no_tail_ack_pt[] = {
	0x10, 0x00, 0x00, 0x00, 0xc4, 0x00,
};
static const uint8_t ack_ctrl_kat_data_no_tail_ack_frame[] = {
	0x21, 0x00, 0x01, 0x00, 0x42, 0x4e, 0x13, 0x04, 0x00, 0x00, 0x73, 0x00,
	0x00, 0x00, 0x08, 0xf0, 0x26, 0x59, 0xc2, 0x70, 0x76, 0xb3, 0x0e, 0x53,
	0x4b, 0xc0, 0xa4, 0x54,
};
static const uint8_t ack_ctrl_kat_data_no_tail_up_pt[] = {
	0x81, 0x02, 0x01, 0x07,
};
static const uint8_t ack_ctrl_kat_data_no_tail_up_frame[] = {
	0x20, 0x01, 0x13, 0x04, 0x00, 0x00, 0x01, 0x00, 0x42, 0x4e, 0x10, 0x00,
	0x00, 0x00, 0x45, 0xa6, 0x07, 0xa9, 0x10, 0x95, 0xae, 0x1c, 0x86, 0xec,
	0x89, 0x07,
};

static const uint8_t ack_ctrl_kat_poll_no_tail_ack_pt[] = {
	0x11, 0x00, 0x00, 0x00, 0xc4, 0x01,
};
static const uint8_t ack_ctrl_kat_poll_no_tail_ack_frame[] = {
	0x21, 0x00, 0x01, 0x00, 0x42, 0x4e, 0x13, 0x04, 0x00, 0x00, 0x74, 0x00,
	0x00, 0x00, 0xd2, 0x02, 0x60, 0x09, 0x85, 0xd2, 0xcf, 0x71, 0xfa, 0x08,
	0x30, 0xa2, 0x06, 0xaf,
};
static const uint8_t ack_ctrl_kat_poll_no_tail_up_pt[] = {
	0x91, 0x21, 0x00,
};
static const uint8_t ack_ctrl_kat_poll_no_tail_up_frame[] = {
	0x20, 0x01, 0x13, 0x04, 0x00, 0x00, 0x01, 0x00, 0x42, 0x4e, 0x11, 0x00,
	0x00, 0x00, 0x6c, 0xfc, 0x9b, 0xae, 0x66, 0xa3, 0x01, 0x20, 0x66, 0x5d,
	0xe9,
};

static const uint8_t ack_ctrl_kat_truncated_no_tail_ack_pt[] = {
	0x12, 0x00, 0x00, 0x00, 0xc4, 0x00,
};
static const uint8_t ack_ctrl_kat_truncated_no_tail_ack_frame[] = {
	0x21, 0x00, 0x01, 0x00, 0x42, 0x4e, 0x13, 0x04, 0x00, 0x00, 0x75, 0x00,
	0x00, 0x00, 0x69, 0x31, 0x1a, 0x0c, 0xbc, 0xca, 0x89, 0x33, 0x51, 0xee,
	0xa1, 0x3d, 0xbf, 0x0f,
};
static const uint8_t ack_ctrl_kat_truncated_no_tail_up_pt[] = {
	0x91, 0x10, 0x00, 0x20, 0x02, 0x00,
};
static const uint8_t ack_ctrl_kat_truncated_no_tail_up_frame[] = {
	0x20, 0x01, 0x13, 0x04, 0x00, 0x00, 0x01, 0x00, 0x42, 0x4e, 0x12, 0x00,
	0x00, 0x00, 0xdd, 0x9b, 0x70, 0xbc, 0xbd, 0xf0, 0x9e, 0xc4, 0x1a, 0xb8,
	0xa0, 0xff, 0xdc, 0x84,
};

static const uint8_t ack_ctrl_kat_hb_unknown_tlv_ack_pt[] = {
	0x05, 0x00, 0x00, 0x00, 0xc7, 0x02, 0x10, 0x04, 0xc7, 0x05, 0x0c, 0x01,
	0x7f, 0x03, 0xaa, 0xbb, 0xcc, 0x20, 0x09, 0x80, 0x3b, 0xb1, 0x6a, 0x80,
	0x05, 0x00, 0x00, 0x00,
};
static const uint8_t ack_ctrl_kat_hb_unknown_tlv_ack_frame[] = {
	0x21, 0x00, 0x01, 0x00, 0x42, 0x4e, 0x13, 0x04, 0x00, 0x00, 0xc8, 0x00,
	0x00, 0x00, 0x73, 0xce, 0x86, 0x8a, 0xb2, 0xc3, 0x2e, 0xa8, 0x26, 0x15,
	0x15, 0x7d, 0x6f, 0x55, 0xd8, 0x3d, 0x09, 0xa5, 0xf6, 0x34, 0x3f, 0xc7,
	0xec, 0xb1, 0xf6, 0x0c, 0x70, 0x56, 0xcd, 0x7a, 0x1c, 0x4e, 0x02, 0x22,
	0xaf, 0x13,
};
static const uint8_t ack_ctrl_kat_hb_unknown_tlv_tlvs[] = {0x10, 0x7f, 0x20};

static const uint8_t ack_ctrl_kat_hb_unknown_tlv_pending_empty_ack_pt[] = {
	0x06, 0x00, 0x00, 0x00, 0xb0, 0x03, 0x10, 0x04, 0xb0, 0xf6, 0x01, 0x01,
	0x3f, 0x00,
};
static const uint8_t ack_ctrl_kat_hb_unknown_tlv_pending_empty_ack_frame[] = {
	0x21, 0x00, 0x01, 0x00, 0x42, 0x4e, 0x13, 0x04, 0x00, 0x00, 0xc9, 0x00,
	0x00, 0x00, 0x59, 0x10, 0xe5, 0xa4, 0xb0, 0xdf, 0x24, 0x40, 0x4a, 0x9a,
	0x14, 0xde, 0x88, 0x7f, 0x77, 0xaf, 0x73, 0x5c, 0x5c, 0xfa, 0x6f, 0x62,
};
static const uint8_t ack_ctrl_kat_hb_unknown_tlv_pending_empty_tlvs[] = {0x10, 0x3f};

static const uint8_t ack_ctrl_kat_hb_lc_ack_pt[] = {
	0x02, 0x00, 0x00, 0x00, 0xc7, 0x02, 0x10, 0x04, 0xc7, 0x05, 0x0c, 0x01,
};
static const uint8_t ack_ctrl_kat_hb_lc_ack_frame[] = {
	0x21, 0x00, 0x01, 0x00, 0x42, 0x4e, 0x13, 0x04, 0x00, 0x00, 0xca, 0x00,
	0x00, 0x00, 0x8e, 0x37, 0x0e, 0xbd, 0x39, 0x39, 0xb6, 0x2d, 0x6b, 0x31,
	0x1c, 0xa1, 0xf9, 0x74, 0xc7, 0x42, 0x9c, 0xc6, 0x27, 0x18,
};
static const uint8_t ack_ctrl_kat_hb_lc_tlvs[] = {0x10};

static const uint8_t ack_ctrl_kat_hb_time_ack_pt[] = {
	0x03, 0x00, 0x00, 0x00, 0xc7, 0x02, 0x20, 0x09, 0x80, 0x3b, 0xb1, 0x6a,
	0x80, 0x03, 0x00, 0x00, 0x00,
};
static const uint8_t ack_ctrl_kat_hb_time_ack_frame[] = {
	0x21, 0x00, 0x01, 0x00, 0x42, 0x4e, 0x13, 0x04, 0x00, 0x00, 0xcb, 0x00,
	0x00, 0x00, 0x17, 0x01, 0xd1, 0x5a, 0x72, 0x55, 0x59, 0x69, 0x5e, 0xee,
	0x53, 0x1d, 0xa6, 0xcd, 0x53, 0xda, 0xd2, 0x18, 0xc6, 0x40, 0x81, 0x56,
	0x96, 0x85, 0xdc,
};
static const uint8_t ack_ctrl_kat_hb_time_tlvs[] = {0x20};

static const struct tower_ack_ctrl_kat tower_ack_ctrl_kat[] = {
	{"lc_only", false, 2u, ack_ctrl_kat_lc_only_up_pt, 3,
	 ack_ctrl_kat_lc_only_up_frame, 25, true, false, 100u,
	 ack_ctrl_kat_lc_only_ack_pt, 12, ack_ctrl_kat_lc_only_ack_frame, 34, NULL, 0},
	{"time_only", false, 3u, ack_ctrl_kat_time_only_up_pt, 3,
	 ack_ctrl_kat_time_only_up_frame, 25, true, false, 101u,
	 ack_ctrl_kat_time_only_ack_pt, 17, ack_ctrl_kat_time_only_ack_frame, 39, NULL, 0},
	{"lc_time", false, 4u, ack_ctrl_kat_lc_time_up_pt, 5,
	 ack_ctrl_kat_lc_time_up_frame, 27, true, false, 102u,
	 ack_ctrl_kat_lc_time_ack_pt, 23, ack_ctrl_kat_lc_time_ack_frame, 45, NULL, 0},
	{"lc_time_pending", false, 5u, ack_ctrl_kat_lc_time_pending_up_pt, 5,
	 ack_ctrl_kat_lc_time_pending_up_frame, 27, true, true, 103u,
	 ack_ctrl_kat_lc_time_pending_ack_pt, 23, ack_ctrl_kat_lc_time_pending_ack_frame, 45, NULL, 0},
	{"lc_time_pending_rep", false, 5u, ack_ctrl_kat_lc_time_pending_rep_up_pt, 5,
	 ack_ctrl_kat_lc_time_pending_rep_up_frame, 27, true, true, 104u,
	 ack_ctrl_kat_lc_time_pending_rep_ack_pt, 23, ack_ctrl_kat_lc_time_pending_rep_ack_frame, 45, NULL, 0},
	{"lc_with_others", false, 6u, ack_ctrl_kat_lc_with_others_up_pt, 28,
	 ack_ctrl_kat_lc_with_others_up_frame, 50, true, false, 105u,
	 ack_ctrl_kat_lc_with_others_ack_pt, 12, ack_ctrl_kat_lc_with_others_ack_frame, 34, NULL, 0},
	{"lc_sf12_margin_zero", false, 7u, ack_ctrl_kat_lc_sf12_margin_zero_up_pt, 3,
	 ack_ctrl_kat_lc_sf12_margin_zero_up_frame, 25, true, false, 106u,
	 ack_ctrl_kat_lc_sf12_margin_zero_ack_pt, 12, ack_ctrl_kat_lc_sf12_margin_zero_ack_frame, 34, NULL, 0},
	{"lc_sf12_margin_neg", false, 8u, ack_ctrl_kat_lc_sf12_margin_neg_up_pt, 3,
	 ack_ctrl_kat_lc_sf12_margin_neg_up_frame, 25, true, false, 107u,
	 ack_ctrl_kat_lc_sf12_margin_neg_ack_pt, 12, ack_ctrl_kat_lc_sf12_margin_neg_ack_frame, 34, NULL, 0},
	{"lc_clamp", false, 9u, ack_ctrl_kat_lc_clamp_up_pt, 3,
	 ack_ctrl_kat_lc_clamp_up_frame, 25, true, false, 108u,
	 ack_ctrl_kat_lc_clamp_ack_pt, 12, ack_ctrl_kat_lc_clamp_ack_frame, 34, NULL, 0},
	{"time_frac_255", false, 10u, ack_ctrl_kat_time_frac_255_up_pt, 3,
	 ack_ctrl_kat_time_frac_255_up_frame, 25, true, false, 109u,
	 ack_ctrl_kat_time_frac_255_ack_pt, 17, ack_ctrl_kat_time_frac_255_ack_frame, 39, NULL, 0},
	{"time_frac_1", false, 11u, ack_ctrl_kat_time_frac_1_up_pt, 3,
	 ack_ctrl_kat_time_frac_1_up_frame, 25, true, false, 110u,
	 ack_ctrl_kat_time_frac_1_ack_pt, 17, ack_ctrl_kat_time_frac_1_ack_frame, 39, NULL, 0},
	{"time_frac_0", false, 12u, ack_ctrl_kat_time_frac_0_up_pt, 3,
	 ack_ctrl_kat_time_frac_0_up_frame, 25, true, false, 111u,
	 ack_ctrl_kat_time_frac_0_ack_pt, 17, ack_ctrl_kat_time_frac_0_ack_frame, 39, NULL, 0},
	{"time_before_anchor", false, 13u, ack_ctrl_kat_time_before_anchor_up_pt, 3,
	 ack_ctrl_kat_time_before_anchor_up_frame, 25, true, false, 112u,
	 ack_ctrl_kat_time_before_anchor_ack_pt, 17, ack_ctrl_kat_time_before_anchor_ack_frame, 39, NULL, 0},
	{"time_no_anchor", false, 14u, ack_ctrl_kat_time_no_anchor_up_pt, 3,
	 ack_ctrl_kat_time_no_anchor_up_frame, 25, false, false, 113u,
	 ack_ctrl_kat_time_no_anchor_ack_pt, 6, ack_ctrl_kat_time_no_anchor_ack_frame, 28, NULL, 0},
	{"lc_time_no_anchor", false, 15u, ack_ctrl_kat_lc_time_no_anchor_up_pt, 5,
	 ack_ctrl_kat_lc_time_no_anchor_up_frame, 27, false, true, 114u,
	 ack_ctrl_kat_lc_time_no_anchor_ack_pt, 12, ack_ctrl_kat_lc_time_no_anchor_ack_frame, 34, NULL, 0},
	{"data_no_tail", false, 16u, ack_ctrl_kat_data_no_tail_up_pt, 4,
	 ack_ctrl_kat_data_no_tail_up_frame, 26, true, false, 115u,
	 ack_ctrl_kat_data_no_tail_ack_pt, 6, ack_ctrl_kat_data_no_tail_ack_frame, 28, NULL, 0},
	{"poll_no_tail", false, 17u, ack_ctrl_kat_poll_no_tail_up_pt, 3,
	 ack_ctrl_kat_poll_no_tail_up_frame, 25, true, true, 116u,
	 ack_ctrl_kat_poll_no_tail_ack_pt, 6, ack_ctrl_kat_poll_no_tail_ack_frame, 28, NULL, 0},
	{"truncated_no_tail", false, 18u, ack_ctrl_kat_truncated_no_tail_up_pt, 6,
	 ack_ctrl_kat_truncated_no_tail_up_frame, 28, true, false, 117u,
	 ack_ctrl_kat_truncated_no_tail_ack_pt, 6, ack_ctrl_kat_truncated_no_tail_ack_frame, 28, NULL, 0},
	{"hb_unknown_tlv", true, 0, NULL, 0, NULL, 0, false, false, 200u,
	 ack_ctrl_kat_hb_unknown_tlv_ack_pt, 28, ack_ctrl_kat_hb_unknown_tlv_ack_frame, 50,
	 ack_ctrl_kat_hb_unknown_tlv_tlvs, 3},
	{"hb_unknown_tlv_pending_empty", true, 0, NULL, 0, NULL, 0, false, false, 201u,
	 ack_ctrl_kat_hb_unknown_tlv_pending_empty_ack_pt, 14, ack_ctrl_kat_hb_unknown_tlv_pending_empty_ack_frame, 36,
	 ack_ctrl_kat_hb_unknown_tlv_pending_empty_tlvs, 2},
	{"hb_lc", true, 0, NULL, 0, NULL, 0, false, false, 202u,
	 ack_ctrl_kat_hb_lc_ack_pt, 12, ack_ctrl_kat_hb_lc_ack_frame, 34,
	 ack_ctrl_kat_hb_lc_tlvs, 1},
	{"hb_time", true, 0, NULL, 0, NULL, 0, false, false, 203u,
	 ack_ctrl_kat_hb_time_ack_pt, 17, ack_ctrl_kat_hb_time_ack_frame, 39,
	 ack_ctrl_kat_hb_time_tlvs, 1},
};

#endif /* TOWER_ACK_CTRL_KAT_H_ */
```

## src/tower_join_kat.h
```c
/* Generated from tests/ccm/tower_join_kat.json, sha256
 * 87cae1a74f8427f56d2f29d2206cdcf882c76547678aaa91d10e1a5285846f42 --
 * the TOWER join KAT shared with the central (plan #470 §6.3), cross-checked
 * with pycryptodome by tower_join_kat.py. Do not edit by hand. */

#ifndef TOWER_JOIN_KAT_H_
#define TOWER_JOIN_KAT_H_

#include <stdint.h>

static const uint8_t tower_join_kat_app_key[] = {
	0x00, 0x01, 0x02, 0x03, 0x04, 0x05, 0x06, 0x07,
	0x08, 0x09, 0x0a, 0x0b, 0x0c, 0x0d, 0x0e, 0x0f,
};

static const uint8_t tower_join_kat_dev_eui[] = {
	0x58, 0x76, 0x07, 0x00, 0x00, 0x00, 0x04, 0x13,
};

static const uint8_t tower_join_kat_join_key[] = {
	0x5f, 0xdd, 0xac, 0x97, 0xce, 0x55, 0xc3, 0xac,
	0xc8, 0x69, 0x2a, 0x5c, 0x15, 0xfd, 0x74, 0x3d,
};

static const uint8_t tower_join_kat_session_key[] = {
	0x78, 0x02, 0x7b, 0x77, 0x91, 0x0b, 0xf7, 0xab,
	0xe8, 0x0b, 0x9f, 0xba, 0xdc, 0x26, 0x45, 0x2e,
};

static const uint8_t tower_join_kat_join_request[] = {
	0x20, 0x00, 0x13, 0x04, 0x00, 0x00, 0x00, 0x00, 0x00, 0x00, 0x11, 0x00, 0x00,
	0x00, 0xd0, 0xa9, 0xaf, 0x7c, 0x3f, 0x74, 0x96, 0x49, 0x50, 0xa9, 0x58, 0x1b,
	0x3e, 0xd0, 0x39, 0x52, 0x70, 0xb3, 0xd1, 0x8e, 0x63, 0x6e, 0xb9, 0x04, 0x15,
};

static const uint8_t tower_join_kat_join_request_plaintext[] = {
	0x91, 0x07, 0x0e, 0x01, 0x01, 0x58, 0x76, 0x07, 0x00,
	0x00, 0x00, 0x04, 0x13, 0x01, 0x05, 0x00, 0x00,
};

static const uint8_t tower_join_kat_join_accept[] = {
	0x20, 0x00, 0x62, 0x96, 0x24, 0x6d, 0x13, 0x04, 0x00, 0x00, 0x11, 0x00, 0x00,
	0x00, 0x15, 0x99, 0xbc, 0xc8, 0x08, 0x8c, 0xba, 0xfd, 0xbc, 0xb7, 0x2b, 0xec,
	0xd1, 0xb6, 0x64, 0x98, 0xee, 0x61, 0x16, 0x3a, 0x80, 0x48, 0x94, 0x74,
};

static const uint8_t tower_join_kat_join_accept_plaintext[] = {
	0x91, 0x08, 0x0d, 0x62, 0x96, 0x24, 0x6d, 0xd4,
	0xc3, 0xb2, 0xa1, 0x01, 0x0e, 0x00, 0x00, 0x00,
};

static const uint8_t tower_join_kat_first_uplink[] = {
	0x20, 0x01, 0x13, 0x04, 0x00, 0x00, 0x62, 0x96, 0x24, 0x6d, 0x01, 0x00, 0x00,
	0x00, 0xe2, 0x69, 0x40, 0xbf, 0x15, 0x60, 0xbb, 0x9b, 0x60, 0x90, 0x33, 0x69,
};

static const uint8_t tower_join_kat_first_uplink_plaintext[] = {
	0x81,
	0x02,
	0x08,
	0x01,
};

#define TOWER_JOIN_KAT_ADDR          1043u
#define TOWER_JOIN_KAT_NET_ID        1831114338u
#define TOWER_JOIN_KAT_DEV_NONCE     17u
#define TOWER_JOIN_KAT_CENTRAL_NONCE 2712847316u

#endif /* TOWER_JOIN_KAT_H_ */
```

## src/tower_pair_kat.h
```c
/* Generated from tests/ccm/tower_pair_kat.json, sha256
 * 3f7839346b4da4d5148fda2832df4f6f8acd1cf8456e4cb65468ec0a1a77ba2c --
 * the TOWER OTA pairing frames (tower-firmware pairing.rs) and an fsk packet,
 * cross-checked with pycryptodome by tower_pair_kat.py (issue #490). Do not
 * edit by hand. */

#ifndef TOWER_PAIR_KAT_H_
#define TOWER_PAIR_KAT_H_

#include <stdint.h>

#define TOWER_PAIR_KAT_GW         0x2d9b924eu
#define TOWER_PAIR_KAT_COUNTER    88u
#define TOWER_PAIR_KAT_CHALLENGE  0xc0ffee11u

static const uint8_t tower_pair_kat_node_key[] = {
	0xa0, 0xa1, 0xa2, 0xa3, 0xa4, 0xa5, 0xa6, 0xa7,
	0xa8, 0xa9, 0xaa, 0xab, 0xac, 0xad, 0xae, 0xaf,
};

static const uint8_t tower_pair_kat_join_req[] = {
	0x24, 0x00, 0x13, 0x04, 0x00, 0x00, 0x00, 0x00,
	0x00, 0x00, 0x58, 0x00, 0x00, 0x00, 0x1a, 0x07,
	0x86, 0xd2, 0xcb, 0x37, 0x1b, 0xad, 0xb9, 0x80,
	0x5f, 0x28,
};

static const uint8_t tower_pair_kat_join_resp[] = {
	0x25, 0x00, 0x4e, 0x92, 0x9b, 0x2d, 0x13, 0x04,
	0x00, 0x00, 0x07, 0x00, 0x00, 0x00, 0xcd, 0x71,
	0x82, 0x3e, 0x07, 0x55, 0xa6, 0x7d, 0x90, 0xe0,
	0x7f, 0x1a, 0x36, 0xa9, 0x44, 0xe5, 0x0b, 0x46,
	0xe8, 0x07, 0x09, 0xc4, 0x73, 0xdb, 0xb3, 0xb5,
	0xe4, 0x04,
};

static const uint8_t tower_pair_kat_join_confirm[] = {
	0x26, 0x00, 0x13, 0x04, 0x00, 0x00, 0x4e, 0x92,
	0x9b, 0x2d, 0x59, 0x00, 0x00, 0x00, 0xca, 0x65,
	0x2c, 0x1b, 0x03, 0x2d, 0x75, 0x19, 0x25, 0x40,
	0x89, 0x87, 0x3e, 0x6e, 0x52, 0x4b,
};

static const uint8_t tower_pair_kat_join_req_fsk[] = {
	0xe5, 0xc5, 0x1d, 0x89, 0xe9, 0x85, 0x33, 0x24,
	0xea, 0x7a, 0xd2, 0x61, 0x70, 0x97, 0x57, 0x10,
	0x53, 0xfb, 0xff, 0x13, 0x5a, 0x16, 0x17, 0x36,
	0xe7, 0x06, 0xef, 0x4d, 0x11,
};

#endif /* TOWER_PAIR_KAT_H_ */
```
