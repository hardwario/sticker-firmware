## CMakeLists.txt
```
# Copyright (c) 2026 HARDWARIO a.s.
# SPDX-License-Identifier: Apache-2.0

cmake_minimum_required(VERSION 3.20.0)

find_package(Zephyr REQUIRED HINTS $ENV{ZEPHYR_BASE})
project(test_app_history)

set(APP_DIR ${CMAKE_CURRENT_SOURCE_DIR}/../../app)

# app_history.c uses no protobuf — just the struct headers from app/src.
target_include_directories(app PRIVATE ${APP_DIR}/src)
target_sources(app PRIVATE
  ${APP_DIR}/src/app_history.c
  ${APP_DIR}/src/app_sensor_types.c
  src/main.c
  src/stubs.c
)
```

## Kconfig
```
# Copyright (c) 2026 HARDWARIO a.s.
# SPDX-License-Identifier: Apache-2.0
#
# Mirror the app's history Kconfig symbols so app_history.c compiles standalone.
# Default to the RAM ring backend with a small ring (forces wrap in tests).

config APP_HISTORY_FLASH
	bool
	default n

config APP_HISTORY_BYTES
	int
	default 64

source "Kconfig.zephyr"
```

## prj.conf
```kconfig
CONFIG_ZTEST=y
CONFIG_LOG=y
CONFIG_LOG_MODE_MINIMAL=y
# APP_HISTORY_BYTES defaults to 64 in the test Kconfig (small ring -> wrap test).
CONFIG_CRC=y
```

## src/stubs.c
```c
/*
 * Copyright (c) 2026 HARDWARIO a.s.
 * SPDX-License-Identifier: Apache-2.0
 *
 * Clock stub for app_history (APP_HISTORY_HAVE_CLOCK). Tests toggle test_clock_*.
 */

#include <stdbool.h>
#include <stdint.h>

bool test_clock_has;
uint32_t test_clock_unix;

int app_clock_get_unix(uint32_t *unix_s)
{
	if (!test_clock_has) {
		return -1;
	}
	*unix_s = test_clock_unix;
	return 0;
}

/* Event log: no flash taken from history in this test. */
uint16_t app_eventlog_flash_pages(void)
{
	return 0;
}
```
