## drivers/sim/Kconfig
```kconfig
#
# Copyright (c) 2026 HARDWARIO a.s.
#
# SPDX-License-Identifier: Apache-2.0
#

config STICKER_SIM
	bool "STICKER simulator peripherals"
	depends on ARCH_POSIX
	select EMUL
	help
	  Emulated STICKER peripherals for the native_sim build of the
	  application: an ADC, I2C sensor emulators and the `sim` shell
	  command that sets their readings. See doc/simulator.md.

config STICKER_SIM_ST25DV
	bool
	default y
	depends on STICKER_SIM && DT_HAS_HARDWARIO_SIM_ST25DV_ENABLED
	help
	  ST25DV NFC tag emulator and its UDP phone link (emul_st25dv.c).
```

## tests/alarm_eval/testcase.yaml
```yaml
common:
  tags: sticker alarm
  platform_allow: native_sim
tests:
  sticker.alarm_eval: {}
```

## tests/alarm_rules/testcase.yaml
```yaml
common:
  tags: sticker alarm
  platform_allow: native_sim
tests:
  sticker.alarm_rules: {}
```

## tests/buzzer/testcase.yaml
```yaml
common:
  tags: sticker buzzer
  platform_allow: native_sim
tests:
  sticker.buzzer: {}
```

## tests/ccm/testcase.yaml
```yaml
common:
  tags: sticker nfc crypto ccm
  platform_allow: native_sim
tests:
  sticker.ccm: {}
```

## tests/cmd/testcase.yaml
```yaml
common:
  tags: sticker cmd
  platform_allow: native_sim
tests:
  sticker.cmd: {}
```

## tests/compose/testcase.yaml
```yaml
common:
  tags: sticker compose
  platform_allow: native_sim
tests:
  sticker.compose: {}
```

## tests/config_legacy/testcase.yaml
```yaml
common:
  tags: sticker config
  platform_allow: native_sim
tests:
  sticker.config_legacy: {}
```

## tests/eventlog/testcase.yaml
```yaml
common:
  tags: sticker eventlog
  platform_allow: native_sim
tests:
  sticker.eventlog: {}
```

## tests/history_flash/testcase.yaml
```yaml
common:
  tags: sticker history
  platform_allow: native_sim
tests:
  sticker.history_flash: {}
```

## tests/lrw_stale/testcase.yaml
```yaml
common:
  tags: sticker lorawan
  platform_allow: native_sim
tests:
  sticker.lrw_stale: {}
```

## tests/ndef/testcase.yaml
```yaml
common:
  tags: sticker ndef
  platform_allow: native_sim
tests:
  sticker.ndef: {}
```

## tests/nfc_crypto/testcase.yaml
```yaml
common:
  tags: sticker nfc crypto
  platform_allow: native_sim
tests:
  sticker.nfc_crypto: {}
```

## tests/nfc_hw/testcase.yaml
```yaml
common:
  tags: sticker nfc hw
  platform_allow: native_sim
tests:
  sticker.nfc_hw: {}
```

## tests/p2p_logic/testcase.yaml
```yaml
common:
  tags: sticker p2p
  platform_allow: native_sim
tests:
  sticker.p2p_logic: {}
```

## tests/radio_common/testcase.yaml
```yaml
common:
  tags: sticker radio
  platform_allow: native_sim
tests:
  sticker.radio_common: {}
```

## tests/sensor_types/testcase.yaml
```yaml
common:
  tags: sticker sensor
  platform_allow: native_sim
tests:
  sticker.sensor_types: {}
```

## tests/slot/testcase.yaml
```yaml
common:
  tags: sticker report
  platform_allow: native_sim
tests:
  sticker.slot: {}
```

## tests/w1_slots/testcase.yaml
```yaml
common:
  tags: sticker w1
  platform_allow: native_sim
tests:
  sticker.w1_slots: {}
```
